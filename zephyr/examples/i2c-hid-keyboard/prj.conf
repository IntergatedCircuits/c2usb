## CMakeLists.txt
```
# SPDX-License-Identifier: Apache-2.0

cmake_minimum_required(VERSION 3.20.0)
find_package(Zephyr REQUIRED HINTS $ENV{ZEPHYR_BASE})
project(i2c-hid-keyboard)

target_sources(app PRIVATE src/main.cpp)
```

## sample.yaml
```
sample:
  description: HID over I2C keyboard sample
  name: I2C HID keyboard
tests:
  c2usb.i2c-hid-keyboard:
    integration_platforms:
      - stm32f072b_disco
      - stm32f4_disco
      - nucleo_l476rg
    platform_allow:
      - stm32f072b_disco
      - stm32f4_disco
      - nucleo_l476rg
    tags:
      - stm32
      - i2c
      - hid
    harness: build
```

## prj.conf
```kconfig
# SPDX-License-Identifier: Apache-2.0
CONFIG_LOG=y

CONFIG_GPIO=y

CONFIG_C2USB=y
CONFIG_C2USB_I2C_HID=y
#CONFIG_C2USB_I2C_STM32_LOG_LEVEL_DBG=y

CONFIG_ASSERT=y
CONFIG_SIZE_OPTIMIZATIONS=y

# don't use picolibc in debug builds as only its module version can print verbose assert() logs
# CONFIG_PICOLIBC_VERBOSE_ASSERT=y
# but that's conflicting with the chosen C++ standard library
CONFIG_NEWLIB_LIBC=y
```

## minimal.conf
```kconfig
CONFIG_MULTITHREADING=n
CONFIG_LOG=n
CONFIG_ASSERT=n
CONFIG_PRINTK=n
CONFIG_CONSOLE=n
CONFIG_UART_CONSOLE=n
CONFIG_SERIAL=n
CONFIG_STDOUT_CONSOLE=n
CONFIG_BOOT_BANNER=n
CONFIG_EARLY_CONSOLE=n
CONFIG_WATCHDOG=n
CONFIG_RESET=n
CONFIG_HW_STACK_PROTECTION=n
CONFIG_THREAD_STACK_INFO=n
CONFIG_ERRNO=n
CONFIG_FAULT_DUMP=0
```

## boards/nucleo_l476rg.overlay
```dts
/* SPDX-License-Identifier: Apache-2.0 */

/*
 * I2C1 on PB8 (SCL, Arduino D15) / PB9 (SDA, Arduino D14), interrupt line on PA8 (Arduino D7).
 * Matching host (Linux) devicetree configuration:
 *
 *   i2c-hid-device@a {
 *     compatible = "hid-over-i2c";
 *     reg = <0x0a>;
 *     hid-descr-addr = <0x0001>;
 *     interrupts-extended = <&gpio 27 IRQ_TYPE_LEVEL_LOW>;
 *   };
 */

&dma1 {
	status = "okay";
};

&i2c1 {
	compatible = "c2usb,stm32-i2c-v2-target";
	clock-frequency = <I2C_BITRATE_STANDARD>;
	/* STM32CubeMX computed value for 80 MHz PCLK1 */
	timings = <80000000 I2C_BITRATE_STANDARD 0x10909CEC>;
	/* I2C1 requests: DMA1 channel 6 (TX) and 7 (RX), request 3 */
	dmas = <&dma1 6 3 (STM32_DMA_PERIPH_TX | STM32_DMA_PRIORITY_HIGH)>,
	       <&dma1 7 3 (STM32_DMA_PERIPH_RX | STM32_DMA_PRIORITY_HIGH)>;
	dma-names = "tx", "rx";
	status = "okay";

	i2c_hid: hid@a {
		compatible = "hid-over-i2c";
		reg = <0x0a>;
		hid-descr-addr = <0x0001>;
		int-gpios = <&gpioa 8 GPIO_ACTIVE_LOW>;
	};
};
```

## boards/stm32f072b_disco.overlay
```dts
/* SPDX-License-Identifier: Apache-2.0 */

/*
 * I2C2 on PB10 (SCL) / PB11 (SDA), interrupt line on PC5.
 * Matching host (Linux) devicetree configuration:
 *
 *   i2c-hid-device@a {
 *     compatible = "hid-over-i2c";
 *     reg = <0x0a>;
 *     hid-descr-addr = <0x0001>;
 *     interrupts-extended = <&gpio 27 IRQ_TYPE_LEVEL_LOW>;
 *   };
 */

&dma1 {
	status = "okay";
};

&i2c2 {
	compatible = "c2usb,stm32-i2c-v2-target";
	clock-frequency = <I2C_BITRATE_STANDARD>;
	/* STM32CubeMX computed value for 48 MHz PCLK1 */
	timings = <48000000 I2C_BITRATE_STANDARD 0x10A35D83>;
	/* I2C2 requests are hardwired to DMA1 channel 4 (TX) and 5 (RX) */
	dmas = <&dma1 4 (STM32_DMA_PERIPH_TX | STM32_DMA_PRIORITY_HIGH)>,
	       <&dma1 5 (STM32_DMA_PERIPH_RX | STM32_DMA_PRIORITY_HIGH)>;
	dma-names = "tx", "rx";
	status = "okay";

	i2c_hid: hid@a {
		compatible = "hid-over-i2c";
		reg = <0x0a>;
		hid-descr-addr = <0x0001>;
		int-gpios = <&gpioc 5 GPIO_ACTIVE_LOW>;
	};
};
```

## boards/stm32f4_disco.overlay
```dts
/* SPDX-License-Identifier: Apache-2.0 */

/*
 * I2C3 on PA8 (SCL) / PC9 (SDA), interrupt line on PC6.
 * Matching host (Linux) devicetree configuration:
 *
 *   i2c-hid-device@a {
 *     compatible = "hid-over-i2c";
 *     reg = <0x0a>;
 *     hid-descr-addr = <0x0001>;
 *     interrupts-extended = <&gpio 27 IRQ_TYPE_LEVEL_LOW>;
 *   };
 */

&dma1 {
	status = "okay";
};

&i2c3 {
	compatible = "c2usb,stm32-i2c-v1-target";
	pinctrl-0 = <&i2c3_scl_pa8 &i2c3_sda_pc9>;
	pinctrl-names = "default";
	clock-frequency = <I2C_BITRATE_STANDARD>;
	/* I2C3 requests: DMA1 stream 4 (TX) and stream 2 (RX), channel 3 */
	dmas = <&dma1 4 3 (STM32_DMA_PERIPH_TX | STM32_DMA_PRIORITY_HIGH) 0>,
	       <&dma1 2 3 (STM32_DMA_PERIPH_RX | STM32_DMA_PRIORITY_HIGH) 0>;
	dma-names = "tx", "rx";
	status = "okay";

	i2c_hid: hid@a {
		compatible = "hid-over-i2c";
		reg = <0x0a>;
		hid-descr-addr = <0x0001>;
		int-gpios = <&gpioc 6 GPIO_ACTIVE_LOW>;
	};
};
```

## src/main.cpp
```c
// SPDX-License-Identifier: Apache-2.0
#include <zephyr/drivers/gpio.h>
#include <zephyr/kernel.h>
#include <zephyr/logging/log.h>

#include "../../iolib.hpp"
#include <hid/example/simple_keyboard.hpp>
#include <i2c/hid/device.hpp>
#include <i2c/vendor/stm32/zephyr_i2c_slave.hpp>

LOG_MODULE_REGISTER(main, LOG_LEVEL_INF);

// the "hid-over-i2c" compatible is also used for remote devices on the controller side,
// make sure that the node describes this device, under an I2C target controller
#define I2C_HID_NODE DT_NODELABEL(i2c_hid)
BUILD_ASSERT(DT_ON_BUS(I2C_HID_NODE, i2c_target), "i2c_hid node must be on an I2C target bus");

static const uint8_t caps_led = 0;
static const gpio_dt_spec button = GPIO_DT_SPEC_GET(DT_ALIAS(sw0), gpios);
static gpio_callback button_cb_data;

/// @brief  Button edge interrupt handler, sends the key state change directly from ISR context.
///         The GPIO interrupt must not preempt the I2C and DMA interrupts (its priority must be
///         numerically equal or higher), so that it behaves as the application context
///         towards the I2C HID device.
///         No debouncing is applied, only the level changes are reported.
static void button_isr(const device*, gpio_callback*, gpio_port_pins_t)
{
    static bool pressed{};
    bool now = gpio_pin_get_dt(&button) > 0;
    if (now != pressed)
    {
        pressed = now;
        simple_keyboard::instance().send_key(hid::page::keyboard_keypad::KEYBOARD_CAPS_LOCK,
                                             pressed);
    }
}

static int button_init()
{
    if (!gpio_is_ready_dt(&button))
    {
        return -ENODEV;
    }
    int ret = gpio_pin_configure_dt(&button, GPIO_INPUT);
    if (ret == 0)
    {
        gpio_init_callback(&button_cb_data, button_isr, BIT(button.pin));
        ret = gpio_add_callback_dt(&button, &button_cb_data);
    }
    if (ret == 0)
    {
        ret = gpio_pin_interrupt_configure_dt(&button, GPIO_INT_EDGE_BOTH);
    }
    return ret;
}

int main(void)
{
    auto* slave = C2USB_I2C_SLAVE_DT_GET(I2C_HID_NODE);
    if (slave == nullptr)
    {
        LOG_ERR("I2C target driver not ready");
        return -ENODEV;
    }

    simple_keyboard::instance().set_leds_callback(
        [](keyboard_leds_data leds)
        { board_leds::set(caps_led, leds.test(hid::page::leds::CAPS_LOCK)); });

    // vendor and product ID are inherited from USB,
    // version indicates product HW / SW version
    static constexpr i2c::hid::product_info product_info{
        CONFIG_DEMO_MANUFACTURER_ID, CONFIG_DEMO_PRODUCT_ID, i2c::hid::version("1.0")};

    static auto i2c_hid_buffer = i2c::hid::device::make_buffer<simple_keyboard::report_protocol>();
    static i2c::hid::device i2c_hid_dev{simple_keyboard::instance(),
                                        product_info,
                                        *slave,
                                        C2USB_I2C_HID_DT_ADDRESS(I2C_HID_NODE),
                                        C2USB_I2C_HID_DT_DESCRIPTOR_REG(I2C_HID_NODE),
                                        i2c_hid_buffer};

    int ret = button_init();
    if (ret != 0)
    {
        LOG_ERR("Button init failed: %d", ret);
        return ret;
    }

    LOG_INF("I2C HID device listening at address 0x%02x", DT_REG_ADDR(I2C_HID_NODE));

    // everything is interrupt driven from here on, but main must not return:
    // without multithreading that would lock the interrupts
    while (true)
    {
#if CONFIG_MULTITHREADING
        k_sleep(K_FOREVER);
#else
        k_cpu_idle();
#endif
    }
}
```
