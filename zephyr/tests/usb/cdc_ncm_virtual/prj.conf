## CMakeLists.txt
```
cmake_minimum_required(VERSION 3.20.0)
find_package(Zephyr REQUIRED HINTS $ENV{ZEPHYR_BASE})
project(c2usb_usb_cdc_ncm_virtual)

set(CMAKE_CXX_FLAGS "${CMAKE_CXX_FLAGS} -fpermissive")

target_include_directories(app PRIVATE
    ${ZEPHYR_BASE}/subsys/usb/host
    ../common
)
target_sources(app PRIVATE
    src/main.cpp
    src/ncm_host_peer.cpp
    ../common/usb_host.cpp
)
```

## prj.conf
```kconfig
CONFIG_LOG=y
CONFIG_ZTEST=y

CONFIG_UDC_ENABLE_SOF=y
CONFIG_C2USB=y
CONFIG_C2USB_UDC_MAC=y
CONFIG_C2USB_CDC_NCM_ETHERNET=y
CONFIG_USB_HOST_STACK=y
CONFIG_UHC_BUF_POOL_SIZE=4096
CONFIG_WARN_EXPERIMENTAL=n
CONFIG_EVENTS=y

CONFIG_NETWORKING=y
CONFIG_NET_L2_ETHERNET=y
CONFIG_ETH_NATIVE_TAP=n
CONFIG_NET_IPV4=y
CONFIG_NET_UDP=y
CONFIG_NET_SOCKETS=y
CONFIG_NET_IF_MAX_IPV4_COUNT=2
CONFIG_NET_IF_UNICAST_IPV4_ADDR_COUNT=2
CONFIG_NET_PKT_RX_COUNT=48
CONFIG_NET_PKT_TX_COUNT=48
CONFIG_NET_BUF_RX_COUNT=192
CONFIG_NET_BUF_TX_COUNT=192
CONFIG_NET_MAX_CONTEXTS=4

CONFIG_MAIN_STACK_SIZE=4096
```

## boards/native_sim.overlay
```dts
/*
 * SPDX-License-Identifier: Apache-2.0
 */

/delete-node/ &zephyr_udc0;

/ {
	zephyr_uhc0: uhc_vrt0 {
		compatible = "zephyr,uhc-virtual";

		zephyr_udc0: udc_vrt0 {
			compatible = "zephyr,udc-virtual";
			num-bidir-endpoints = <8>;
			maximum-speed = "high-speed";
		};
	};

	cdc_ncm_eth0: cdc-ncm-eth0 {
		compatible = "c2usb,cdc-ncm-ethernet";
		function-name = "c2usb-ncm-test";
	};
};
```

## src/ncm_host_peer.cpp
```c
#include "ncm_host_peer.hpp"

ncm_host_peer::ncm_host_peer(usb::test::device* dev)
    : dev_(dev), tx_(tx_buffer_), rx_(rx_buffer_)
{
    tx_.max_size = tx_.size();
    tx_.init();
}

bool ncm_host_peer::queue_datagram(std::span<const uint8_t> datagram)
{
    return tx_.append_datagram(datagram.begin(), datagram.end());
}

int ncm_host_peer::transmit()
{
    auto ntb = tx_.pop_ntb();
    if (ntb.empty())
    {
        return -EINVAL;
    }
    return transmit_ntb(ntb);
}

int ncm_host_peer::transmit_malformed(std::span<const uint8_t> datagram)
{
    if (not queue_datagram(datagram))
    {
        return -ENOSPC;
    }
    auto ntb = tx_.pop_ntb();
    if (ntb.empty())
    {
        return -EINVAL;
    }
    const_cast<uint8_t*>(ntb.data())[0] ^= 0xff;
    return transmit_ntb(ntb);
}

int ncm_host_peer::transmit_ntb(std::span<const uint8_t> ntb)
{
    auto* endpoint = dev_->ep_out[0x02].desc;
    if (endpoint == nullptr)
    {
        return -ENODEV;
    }

    const size_t max_packet_size = USB_MPS_EP_SIZE(endpoint->wMaxPacketSize);
    if (max_packet_size == 0)
    {
        return -EINVAL;
    }

    for (size_t offset = 0; offset < ntb.size();)
    {
        const size_t chunk_size = std::min(max_packet_size, ntb.size() - offset);
        size_t transferred{};
        int err =
            usb::test::bulk_transfer(dev_, 0x02, ntb.subspan(offset, chunk_size), transferred);
        if ((err != 0) or (transferred != chunk_size))
        {
            return err != 0 ? err : -EIO;
        }
        offset += chunk_size;
    }
    return 0;
}

int ncm_host_peer::receive(std::span<std::span<const uint8_t>> datagrams, size_t& datagram_count,
                           std::chrono::milliseconds timeout, size_t* ntb_size)
{
    rx_.page = 0;
    auto buffer = std::span<uint8_t>{rx_.data(0), rx_.size()};
    size_t transferred{};
    int err = usb::test::bulk_transfer(dev_, 0x82, buffer, transferred, timeout);
    if (err != 0)
    {
        return err;
    }
    if ((transferred == 0) or (transferred > buffer.size()))
    {
        return -EBADMSG;
    }
    if (ntb_size != nullptr)
    {
        *ntb_size = transferred;
    }

    rx_.length[0] = transferred;
    auto ntb = std::span<const uint8_t>{buffer.data(), transferred};
    if (not usb::cdc::ncm::is_valid_ntb<16>(ntb))
    {
        return -EBADMSG;
    }
    rx_.set_header(buffer.data());

    datagram_count = 0;
    while (true)
    {
        auto datagram = rx_.pop_datagram();
        if (datagram.empty())
        {
            break;
        }
        if (datagram_count == datagrams.size())
        {
            return -ENOSPC;
        }
        datagrams[datagram_count++] = datagram;
    }
    return datagram_count == 0 ? -EBADMSG : 0;
}

int ncm_host_peer::receive_notification(std::span<uint8_t> data, size_t& transferred,
                                        std::chrono::milliseconds timeout)
{
    return usb::test::bulk_transfer(dev_, 0x81, data, transferred, timeout);
}
```

## src/ncm_host_peer.hpp
```c
#pragma once
#include <array>
#include <cstddef>
#include <cstdint>
#include <span>
#include <usb/class/cdc_ncm_ntb.hpp>
#include <usb_host.hpp>

class ncm_host_peer
{
  public:
    explicit ncm_host_peer(usb::test::device* dev);

    bool queue_datagram(std::span<const uint8_t> datagram);
    int transmit();
    int transmit_malformed(std::span<const uint8_t> datagram);
    int receive(std::span<std::span<const uint8_t>> datagrams, size_t& datagram_count,
                std::chrono::milliseconds timeout = std::chrono::milliseconds(3000),
                size_t* ntb_size = nullptr);
    int receive_notification(std::span<uint8_t> data, size_t& transferred,
                             std::chrono::milliseconds timeout = std::chrono::milliseconds(3000));

  private:
    int transmit_ntb(std::span<const uint8_t> ntb);

    static constexpr size_t NTB_WORD_COUNT = 1024;
    usb::test::device* dev_;
    std::array<uint32_t, NTB_WORD_COUNT> tx_buffer_{};
    std::array<uint32_t, NTB_WORD_COUNT> rx_buffer_{};
    usb::cdc::ncm::ntb_tx_ctx<16> tx_;
    usb::cdc::ncm::ntb_rx_ctx<16> rx_;
};
```
