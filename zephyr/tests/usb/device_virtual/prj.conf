## CMakeLists.txt
```
cmake_minimum_required(VERSION 3.20.0)
find_package(Zephyr REQUIRED HINTS $ENV{ZEPHYR_BASE})
project(c2usb_usb_device_virtual)

set(CMAKE_CXX_FLAGS "${CMAKE_CXX_FLAGS} -fpermissive")

target_include_directories(app PRIVATE
    ${ZEPHYR_BASE}/subsys/usb/host
    ${ZEPHYR_BASE}/subsys/mgmt/mcumgr/transport/include
    ../common
)
target_sources(app PRIVATE
    src/main.cpp
    src/cdc_helpers.cpp
    ../common/usb_host.cpp
)

if(CONFIG_C2USB_SHELL_BACKEND AND NOT CONFIG_C2USB_MCUMGR_SMP_CONSOLE)
    target_sources(app PRIVATE src/shell_tests.cpp)
endif()

if(CONFIG_C2USB_SHELL_MCUMGR_TRANSPORT OR CONFIG_C2USB_MCUMGR_SMP_CONSOLE)
    target_sources(app PRIVATE src/smp_tests.cpp)
endif()
```

## prj.conf
```kconfig
CONFIG_LOG=y
CONFIG_ZTEST=y

CONFIG_UDC_ENABLE_SOF=y
CONFIG_C2USB=y
CONFIG_C2USB_UDC_MAC=y
CONFIG_C2USB_HID_BOOT_PROTOCOL=y
CONFIG_C2USB_SHELL_BACKEND=y
CONFIG_SHELL=y

CONFIG_USB_HOST_STACK=y
CONFIG_WARN_EXPERIMENTAL=n

CONFIG_MAIN_STACK_SIZE=4096
```

## boards/native_sim.overlay
```dts
/*
 * SPDX-License-Identifier: Apache-2.0
 */

/delete-node/ &zephyr_udc0;

/ {
	zephyr_uhc0: uhc_vrt0 {
		compatible = "zephyr,uhc-virtual";

		zephyr_udc0: udc_vrt0 {
			compatible = "zephyr,udc-virtual";
			num-bidir-endpoints = <8>;
			maximum-speed = "high-speed";
		};
	};
};
```

## boards/native_sim_native_64.overlay
```dts
/*
 * SPDX-License-Identifier: Apache-2.0
 */

#include "native_sim.overlay"
```

## boards/qemu_cortex_m3.overlay
```dts
/*
 * SPDX-License-Identifier: Apache-2.0
 */

/ {
	zephyr_uhc0: uhc_vrt0 {
		compatible = "zephyr,uhc-virtual";

		zephyr_udc0: udc_vrt0 {
			compatible = "zephyr,udc-virtual";
			num-bidir-endpoints = <8>;
			maximum-speed = "high-speed";
		};
	};
};
```

## src/cdc_helpers.cpp
```c
#include "cdc_helpers.hpp"
#include <algorithm>
#include <cstring>
#include <zephyr/kernel.h>

using namespace std::chrono_literals;
using namespace zephyr;

namespace c2usb::device_virtual
{
bool configure_cdc_shell(usb::test::device* dev)
{
    return configure_cdc_interface(dev, 0);
}

bool configure_cdc_interface(usb::test::device* dev, uint8_t interface_index)
{
    auto configuration = dev->get_configuration();
    if (!configuration)
    {
        return false;
    }
    if (configuration.value() == 0 and !dev->set_configuration(1))
    {
        return false;
    }

    return set_cdc_line_state(dev, interface_index, true);
}

bool set_cdc_line_state(usb::test::device* dev, uint8_t interface_index, bool dtr)
{
    const auto request = usb::control::request{usb::cdc::control::SET_CONTROL_LINE_STATE,
                                               static_cast<uint16_t>(dtr), interface_index};
    return dev->control_out(request);
}

int send_bulk(usb::test::device* dev, std::span<const uint8_t> data)
{
    auto* out_ep = dev->ep_out[0x01].desc;
    if (out_ep == nullptr)
    {
        return -ENODEV;
    }
    const size_t max_transfer_size = USB_MPS_EP_SIZE(out_ep->wMaxPacketSize);
    if (max_transfer_size == 0)
    {
        return -EINVAL;
    }

    for (size_t offset = 0; offset < data.size();)
    {
        const size_t chunk_size = std::min(max_transfer_size, data.size() - offset);
        size_t transferred{};
        int err =
            usb::test::bulk_transfer(dev, 0x01, data.subspan(offset, chunk_size), transferred);
        if (err != 0 or transferred != chunk_size)
        {
            return err != 0 ? err : -EIO;
        }
        offset += chunk_size;
    }
    return 0;
}

int send_text(usb::test::device* dev, std::string_view text)
{
    return send_bulk(dev, {reinterpret_cast<const uint8_t*>(text.data()), text.size()});
}

size_t count_text(std::span<const uint8_t> bytes, std::string_view text)
{
    size_t count{};
    auto it = bytes.begin();
    while (it != bytes.end())
    {
        auto found = std::ranges::search(it, bytes.end(), text.begin(), text.end());
        if (found.begin() == bytes.end())
        {
            break;
        }
        ++count;
        it = found.begin() + text.size();
    }
    return count;
}

bool read_until(usb::test::device* dev, std::span<uint8_t> output, size_t& output_size,
                std::span<const uint8_t> expected, size_t marker_count, std::string_view marker,
                uint8_t endpoint)
{
    std::array<uint8_t, 64> packet{};
    for (size_t attempt = 0; attempt < 256; ++attempt)
    {
        size_t received{};
        int err = usb::test::bulk_transfer(dev, endpoint, std::span<uint8_t>{packet}, received);
        if (err != 0)
        {
            return false;
        }
        if (received > output.size() - output_size)
        {
            return false;
        }
        std::copy_n(packet.begin(), received, output.begin() + output_size);
        output_size += received;
        auto bytes = std::span<const uint8_t>{output.data(), output_size};
        auto match = std::ranges::search(bytes, expected);
        if (match.begin() != bytes.end() and count_text(bytes, marker) >= marker_count)
        {
            return true;
        }
    }
    return false;
}
} // namespace c2usb::device_virtual
```

## src/cdc_helpers.hpp
```c
#pragma once

#include <cstddef>
#include <cstdint>
#include <span>
#include <string_view>

#include <usb/class/cdc.hpp>
#include <usb_host.hpp>

namespace c2usb::device_virtual
{
bool configure_cdc_shell(usb::test::device* dev);
int send_bulk(usb::test::device* dev, std::span<const uint8_t> data);
int send_text(usb::test::device* dev, std::string_view text);
size_t count_text(std::span<const uint8_t> bytes, std::string_view text);
bool read_until(usb::test::device* dev, std::span<uint8_t> output, size_t& output_size,
                std::span<const uint8_t> expected, size_t marker_count, std::string_view marker);
} // namespace c2usb::device_virtual
```

## src/shell_test_commands.hpp
```c
#pragma once

namespace c2usb::device_virtual
{
void reset_marker_command_count();
unsigned get_marker_command_count();
} // namespace c2usb::device_virtual
```

## src/shell_tests.cpp
```c
#include "cdc_helpers.hpp"
#include "shell_test_commands.hpp"

#include <array>
#include <atomic>

#include <zephyr/shell/shell.h>
#include <zephyr/thread.hpp>
#include <zephyr/ztest.h>

#include <usb/df/vendor/zephyr/shell.hpp>

using namespace std::chrono_literals;
using namespace zephyr;

extern "C" const struct shell* c2usb_shell_handle();

namespace c2usb::device_virtual
{
std::atomic<unsigned> marker_command_count{};

void reset_marker_command_count()
{
    marker_command_count.store(0);
}

unsigned get_marker_command_count()
{
    return marker_command_count.load();
}
} // namespace c2usb::device_virtual

using namespace c2usb::device_virtual;

int c2usb_mark_command(const struct shell* sh, size_t argc, char** argv)
{
    marker_command_count.fetch_add(1);
    shell_print(sh, "C2USB_EDGE_MARK");
    return 0;
}
SHELL_CMD_REGISTER(c2usb_mark, NULL, "c2usb test marker", c2usb_mark_command);

int c2usb_stress_command(const struct shell* sh, size_t argc, char** argv)
{
    shell_print(sh, "C2USB_SHELL_BEGIN");
    for (unsigned i = 0; i < 32; ++i)
    {
        shell_fprintf(sh, SHELL_NORMAL, "C2USB_SHELL_DATA_%02u_0123456789abcdef\n", i);
    }
    shell_print(sh, "C2USB_SHELL_END");
    return 0;
}
SHELL_CMD_REGISTER(c2usb_stress, NULL, "c2usb TX backpressure test", c2usb_stress_command);

ZTEST(c2usb_usb_device_virtual, test_shell_cdc_command_round_trip)
{
    auto* dev = usb::test::host::wait_for_device();
    zassert_not_null(dev, "No USB device enumerated on virtual host");
    zassert_true(c2usb::device_virtual::configure_cdc_shell(dev),
                 "Failed to configure the CDC shell");
    zassert_true(usb::df::zephyr::shell::handle().get_line_config().data_terminal_ready(),
                 "CDC DTR was not enabled");
    zassert_true(::shell_ready(c2usb_shell_handle()), "Shell did not become ready");

    reset_marker_command_count();
    zassert_equal(c2usb::device_virtual::send_text(dev, "c2usb_mark\n"), 0,
                  "Failed to send marker command");
    for (size_t attempt = 0; attempt < 100 and get_marker_command_count() == 0; ++attempt)
    {
        this_thread::sleep_for(1ms);
    }
    zassert_equal(get_marker_command_count(), 1, "Shell did not dispatch the marker command");

    std::array<uint8_t, 512> output{};
    size_t output_size{};
    zassert_true(
        c2usb::device_virtual::read_until(dev, output, output_size, {}, 1, "C2USB_EDGE_MARK"),
        "Shell output was not received over CDC");
}

ZTEST(c2usb_usb_device_virtual, test_shell_cdc_command_split_across_transfers)
{
    auto* dev = usb::test::host::wait_for_device();
    zassert_not_null(dev, "No USB device enumerated on virtual host");
    zassert_true(c2usb::device_virtual::configure_cdc_shell(dev),
                 "Failed to configure the CDC shell");

    reset_marker_command_count();
    zassert_equal(c2usb::device_virtual::send_text(dev, "c2usb_"), 0,
                  "Failed to send first command fragment");
    zassert_equal(c2usb::device_virtual::send_text(dev, "mark\n"), 0,
                  "Failed to send second command fragment");
    for (size_t attempt = 0; attempt < 100 and get_marker_command_count() == 0; ++attempt)
    {
        this_thread::sleep_for(1ms);
    }
    zassert_equal(get_marker_command_count(), 1,
                  "Shell did not assemble the command across USB transfers");

    std::array<uint8_t, 512> output{};
    size_t output_size{};
    zassert_true(
        c2usb::device_virtual::read_until(dev, output, output_size, {}, 1, "C2USB_EDGE_MARK"),
        "Split shell command output was not received over CDC");
}
```

## src/smp_tests.cpp
```c
#include "cdc_helpers.hpp"
#include "shell_test_commands.hpp"

#include <array>
#include <cstring>
#include <string_view>

#include <mgmt/mcumgr/transport/smp_internal.h>
#include <zephyr/kernel.h>
#include <zephyr/mgmt/mcumgr/grp/os_mgmt/os_mgmt.h>
#include <zephyr/mgmt/mcumgr/mgmt/mgmt.h>
#include <zephyr/mgmt/mcumgr/smp/smp.h>
#include <zephyr/sys/byteorder.h>
#include <zephyr/thread.hpp>
#include <zephyr/ztest.h>

#include <usb/df/vendor/zephyr/shell.hpp>

using namespace std::chrono_literals;
using namespace zephyr;

extern "C" const struct shell* c2usb_shell_handle();

struct serial_bytes
{
    std::array<uint8_t, 256> bytes{};
    size_t size{};
};

serial_bytes* serial_capture;

static int capture_serial_bytes(const void* data, int len)
{
    if (serial_capture == nullptr or len < 0 or
        serial_capture->size + static_cast<size_t>(len) > serial_capture->bytes.size())
    {
        return -ENOMEM;
    }
    std::memcpy(serial_capture->bytes.data() + serial_capture->size, data, len);
    serial_capture->size += len;
    return 0;
}

static serial_bytes make_echo_packet(std::string_view value, uint8_t op, uint8_t seq, char key,
                                     bool indefinite_map = false)
{
    std::array<uint8_t, 256> raw{};
    struct smp_hdr hdr{};
    size_t payload_size = value.size() + 4 + (value.size() > 23 ? 1 : 0) + indefinite_map;
    hdr.nh_len = sys_cpu_to_be16(payload_size);
    hdr.nh_flags = 0;
    hdr.nh_op = op;
    hdr.nh_group = sys_cpu_to_be16(MGMT_GROUP_ID_OS);
    hdr.nh_seq = seq;
    hdr.nh_id = OS_MGMT_ID_ECHO;
    hdr.nh_version = 1;
    std::memcpy(raw.data(), &hdr, sizeof(hdr));

    size_t offset = sizeof(hdr);
    raw[offset++] = indefinite_map ? 0xbf : 0xa1;
    raw[offset++] = 0x61;
    raw[offset++] = static_cast<uint8_t>(key);
    if (value.size() <= 23)
    {
        raw[offset++] = 0x60 | static_cast<uint8_t>(value.size());
    }
    else
    {
        raw[offset++] = 0x78;
        raw[offset++] = static_cast<uint8_t>(value.size());
    }
    std::memcpy(raw.data() + offset, value.data(), value.size());
    offset += value.size();
    if (indefinite_map)
    {
        raw[offset++] = 0xff;
    }

    serial_bytes result{};
    serial_capture = &result;
    int err = mcumgr_serial_tx_pkt(raw.data(), offset, capture_serial_bytes);
    serial_capture = nullptr;
    if (err != 0)
    {
        result.size = 0;
    }
    return result;
}

ZTEST(c2usb_usb_device_virtual, test_smp_demux_boundaries_and_recovery)
{
    auto* dev = usb::test::host::wait_for_device();
    zassert_not_null(dev, "No USB device enumerated on virtual host");
    zassert_true(c2usb::device_virtual::configure_cdc_shell(dev),
                 "Failed to configure the CDC shell");
    zassert_true(usb::df::zephyr::shell::handle().get_line_config().data_terminal_ready(),
                 "CDC DTR was not enabled");
    zassert_true(::shell_ready(c2usb_shell_handle()), "Shell did not become ready");

    const uint8_t false_prefix = MCUMGR_SERIAL_HDR_PKT_1;
    int send_error = c2usb::device_virtual::send_bulk(dev, {&false_prefix, 1});
    zassert_equal(send_error, 0, "Failed to send split false prefix: %d", send_error);
    c2usb::device_virtual::reset_marker_command_count();
    zassert_equal(c2usb::device_virtual::send_text(dev, "c2usb_mark\n"), 0,
                  "Failed to send marker command");
    for (size_t attempt = 0;
         attempt < 100 and c2usb::device_virtual::get_marker_command_count() == 0; ++attempt)
    {
        this_thread::sleep_for(1ms);
    }
    zassert_equal(c2usb::device_virtual::get_marker_command_count(), 1,
                  "Shell did not dispatch the marker command");

    static std::array<uint8_t, 4096> output{};
    size_t output_size{};
    zassert_true(
        c2usb::device_virtual::read_until(dev, output, output_size, {}, 1, "C2USB_EDGE_MARK"),
        "False SMP prefix lost the following shell command");

    constexpr std::string_view payload = "mixed-rx";
    constexpr uint8_t sequence = 17;
    auto request = make_echo_packet(payload, MGMT_OP_WRITE, sequence, 'd');
    auto response = make_echo_packet(payload, MGMT_OP_WRITE_RSP, sequence, 'r', true);
    zassert_true(request.size > 0 and response.size > 0, "Failed to build serial echo frames");

    std::array<uint8_t, 64> first_transfer{};
    constexpr std::string_view marker_command = "c2usb_mark\n";
    std::memcpy(first_transfer.data(), marker_command.data(), marker_command.size());
    first_transfer[marker_command.size()] = request.bytes[0];
    zassert_equal(
        c2usb::device_virtual::send_bulk(dev, {first_transfer.data(), marker_command.size() + 1}),
        0, "Failed to send shell bytes and first SMP prefix byte");
    zassert_equal(c2usb::device_virtual::send_bulk(dev, {request.bytes.data() + 1, 1}), 0,
                  "Failed to split SMP prefix across USB transfers");

    std::array<uint8_t, 512> final_transfer{};
    const size_t request_tail = request.size - 2;
    std::memcpy(final_transfer.data(), request.bytes.data() + 2, request_tail);
    std::memcpy(final_transfer.data() + request_tail, marker_command.data(), marker_command.size());
    zassert_equal(c2usb::device_virtual::send_bulk(
                      dev, {final_transfer.data(), request_tail + marker_command.size()}),
                  0, "Failed to send SMP payload and trailing shell command");

    output_size = 0;
    zassert_true(c2usb::device_virtual::read_until(dev, output, output_size,
                                                   {response.bytes.data(), response.size}, 2,
                                                   "C2USB_EDGE_MARK"),
                 "Mixed shell/SMP input did not produce both shell commands and SMP response");

    static std::array<uint8_t, MCUMGR_SERIAL_MAX_FRAME + 32> oversized{};
    oversized[0] = MCUMGR_SERIAL_HDR_PKT_1;
    oversized[1] = MCUMGR_SERIAL_HDR_PKT_2;
    std::fill(oversized.begin() + 2, oversized.end() - 1, 'x');
    oversized.back() = '\n';
    zassert_equal(c2usb::device_virtual::send_bulk(dev, oversized), 0,
                  "Failed to send oversized SMP fragment");
    zassert_equal(c2usb::device_virtual::send_text(dev, "c2usb_mark\n"), 0,
                  "Failed to send marker after oversized SMP fragment");

    output_size = 0;
    zassert_true(
        c2usb::device_virtual::read_until(dev, output, output_size, {}, 1, "C2USB_EDGE_MARK"),
        "Shell stream did not recover after oversized SMP fragment");
}

ZTEST(c2usb_usb_device_virtual, test_smp_tx_backpressure_serializes_shell_writer)
{
    auto* dev = usb::test::host::wait_for_device();
    zassert_not_null(dev, "No USB device enumerated on virtual host");
    zassert_true(c2usb::device_virtual::configure_cdc_shell(dev),
                 "Failed to configure the CDC shell");
    zassert_true(usb::df::zephyr::shell::handle().get_line_config().data_terminal_ready(),
                 "CDC DTR was not enabled");
    zassert_true(::shell_ready(c2usb_shell_handle()), "Shell did not become ready");

    c2usb::device_virtual::reset_marker_command_count();
    int send_error = c2usb::device_virtual::send_text(dev, "c2usb_mark\n");
    zassert_equal(send_error, 0, "Failed to prime the shell backend: %d", send_error);
    for (size_t attempt = 0;
         attempt < 100 and c2usb::device_virtual::get_marker_command_count() == 0; ++attempt)
    {
        this_thread::sleep_for(1ms);
    }
    zassert_equal(c2usb::device_virtual::get_marker_command_count(), 1,
                  "Shell did not dispatch the marker command");
    static std::array<uint8_t, 4096> output{};
    size_t output_size{};
    zassert_true(
        c2usb::device_virtual::read_until(dev, output, output_size, {}, 1, "C2USB_EDGE_MARK"),
        "Shell backend did not become ready");

    const auto* sh = c2usb_shell_handle();
    bool shell_unlocked{};
    for (size_t attempt = 0; attempt < 1000; ++attempt)
    {
        if (k_sem_count_get(&sh->ctx->lock_sem) == 1)
        {
            shell_unlocked = true;
            break;
        }
        this_thread::sleep_for(1ms);
    }
    zassert_true(shell_unlocked, "Shell backend lock did not become available");

    std::array<char, 100> payload{};
    payload.fill('L');
    const std::string_view echo{payload.data(), payload.size()};
    constexpr uint8_t sequence = 23;
    auto request = make_echo_packet(echo, MGMT_OP_WRITE, sequence, 'd');
    auto response = make_echo_packet(echo, MGMT_OP_WRITE_RSP, sequence, 'r', true);
    zassert_true(request.size > 128 and response.size > 128,
                 "Echo frames must exceed the configured TX double buffer");
    zassert_equal(c2usb::device_virtual::send_bulk(dev, {request.bytes.data(), request.size}), 0,
                  "Failed to send long SMP echo request");

    bool smp_holds_shell_lock{};
    for (size_t attempt = 0; attempt < 2000; ++attempt)
    {
        if (k_sem_count_get(&sh->ctx->lock_sem) == 0)
        {
            smp_holds_shell_lock = true;
            break;
        }
        this_thread::sleep_for(1ms);
    }
    zassert_true(smp_holds_shell_lock, "SMP response did not acquire the shell TX lock");
    this_thread::sleep_for(30ms);
    zassert_equal(k_sem_count_get(&sh->ctx->lock_sem), 0,
                  "SMP response did not remain blocked by TX backpressure");

    zassert_equal(c2usb::device_virtual::send_text(dev, "c2usb_stress\n"), 0,
                  "Failed to queue concurrent shell output");

    output_size = 0;
    zassert_true(c2usb::device_virtual::read_until(dev, output, output_size,
                                                   {response.bytes.data(), response.size}, 1,
                                                   "C2USB_SHELL_END"),
                 "Timed out draining SMP and shell output");
    auto stream = std::span<const uint8_t>{output.data(), output_size};
    zassert_true(c2usb::device_virtual::count_text(stream, "C2USB_SHELL_BEGIN") == 1,
                 "Concurrent shell output was not delivered");
    auto frame_match =
        std::ranges::search(stream, std::span<const uint8_t>{response.bytes.data(), response.size});
    auto shell_match = std::ranges::search(stream, std::string_view{"C2USB_SHELL_BEGIN"});
    zassert_true(frame_match.begin() < shell_match.begin(),
                 "Shell output interleaved before the complete SMP serial response");
}
```
