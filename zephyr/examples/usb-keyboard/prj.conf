## CMakeLists.txt
```
# SPDX-License-Identifier: Apache-2.0

cmake_minimum_required(VERSION 3.20.0)
find_package(Zephyr REQUIRED HINTS $ENV{ZEPHYR_BASE})
project(usb-keyboard)

target_sources(app PRIVATE src/main.cpp)
```

## Kconfig
```
# SPDX-License-Identifier: Apache-2.0
rsource "../Kconfig"
```

## sample.yaml
```
sample:
  description: USB HID keyboard sample
  name: USB HID keyboard
tests:
  c2usb.usb-keyboard:
    sysbuild: true
    integration_platforms:
      - nrf52840dk/nrf52840
      - nrf54lm20dk/nrf54lm20a/cpuapp
    platform_allow:
      - nrf52dk/nrf52832
      - nrf52840dk/nrf52840
      - nrf5340dk/nrf5340/cpuapp
      - nrf5340dk/nrf5340/cpuapp/ns
      - nrf54l15dk/nrf54l05/cpuapp
      - nrf54l15dk/nrf54l10/cpuapp
      - nrf54l15dk/nrf54l15/cpuapp
      - nrf54lm20dk/nrf54lm20a/cpuapp
      - nrf54lm20dk/nrf54lm20b/cpuapp
      - nrf54ls05dk/nrf54ls05b/cpuapp
      - nrf54lv10dk/nrf54lv10a/cpuapp
      - nrf54lv10dk/nrf54lv10a/cpuapp/ns
      - nrf54h20dk/nrf54h20/cpuapp
    tags:
      - usb
      - hid
    harness: build
```

## prj.conf
```kconfig
# SPDX-License-Identifier: Apache-2.0
CONFIG_LOG=y

# limit to full-speed USB, sufficient for a keyboard
CONFIG_UDC_DRIVER_HIGH_SPEED_SUPPORT_ENABLED=n
CONFIG_UDC_DRIVER_LOG_LEVEL_WRN=y
#CONFIG_C2USB_UDC_MAC_LOG_LEVEL_DBG=y

CONFIG_INPUT=y
CONFIG_INPUT_MODE_SYNCHRONOUS=y
CONFIG_HWINFO=y

CONFIG_C2USB=y
CONFIG_C2USB_UDC_MAC=y
CONFIG_C2USB_HID_BOOT_PROTOCOL=y
# RAM optimization:
# the buffer pool size can be cut down, as it's only used for control transfers
# CONFIG_UDC_BUF_POOL_SIZE=optimize based on your application (and check asserts)
# CONFIG_UDC_BUF_COUNT=3 + maximal used endpoint count in a configuration

CONFIG_ASSERT=y
CONFIG_SIZE_OPTIMIZATIONS=y
CONFIG_DEBUG_THREAD_INFO=y

# don't use picolibc in debug builds as only its module version can print verbose assert() logs
# CONFIG_PICOLIBC_VERBOSE_ASSERT=y
# but that's conflicting with the chosen C++ standard library
CONFIG_NEWLIB_LIBC=y

CONFIG_USE_SEGGER_RTT=n
```

## src/main.cpp
```c
// SPDX-License-Identifier: Apache-2.0
#include <zephyr/drivers/hwinfo.h>
#include <zephyr/input/input.h>
#include <zephyr/logging/log.h>

#include "../../iolib.hpp"
#include <hid/example/simple_keyboard.hpp>
#include <usb/df/class/hid.hpp>
#include <usb/df/config_factory.hpp>
#include <usb/df/device.hpp>
#include <usb/df/vendor/zephyr/udc_mac.hpp>
#include <zephyr/message_queue.hpp>

LOG_MODULE_REGISTER(main, LOG_LEVEL_INF);

using namespace magic_enum::bitwise_operators;
using namespace zephyr;

static const uint8_t caps_led = 0;

auto& input_msgq()
{
    static message_queue_instance<input_event, 2> msgq;
    return msgq;
}

static void input_cb(input_event* evt, void*)
{
    input_msgq().post(*evt);
}

INPUT_CALLBACK_DEFINE(nullptr, input_cb, nullptr);

#if CONFIG_HWINFO
static uint8_t serial_number[CONFIG_HWINFO_DEVICE_ID_LENGTH]{};
#endif
constexpr usb::product_info product_info{CONFIG_DEMO_MANUFACTURER_ID,
                                         CONFIG_DEMO_MANUFACTURER,
                                         CONFIG_DEMO_PRODUCT_ID,
                                         CONFIG_DEMO_PRODUCT,
                                         usb::version("1.0")
#if CONFIG_HWINFO
                                             ,
                                         serial_number
#endif
};

auto& device()
{
    static usb::df::zephyr::udc_mac mac{DEVICE_DT_GET(DT_NODELABEL(zephyr_udc0)), 400};
    static usb::df::device_instance<mac.supported_speeds()> device{mac, product_info};
    return device;
}

//[[noreturn]]
int main(void)
{
#if CONFIG_HWINFO
    // use HW info as serial number
    hwinfo_get_device_id(serial_number, sizeof(serial_number));
#endif

    simple_keyboard::instance().set_leds_callback(
        [](keyboard_leds_data leds)
        { board_leds::set(caps_led, leds.test(hid::page::leds::CAPS_LOCK)); });

    // observing device state
    device().set_power_event_delegate(
        [](usb::df::device& dev, usb::df::device::event ev)
        {
            if (ev == usb::df::device::event::CONFIGURATION_CHANGE)
            {
                LOG_INF("USB configured: %u, speed: %s, granted current: %uuA",
                        (unsigned)dev.configured(), magic_enum::enum_name(dev.bus_speed()).data(),
                        dev.granted_bus_current_uA());
            }
            else
            {
                LOG_INF("USB power state: %s, granted current: %uuA",
                        magic_enum::enum_name(dev.power_state()).data(),
                        dev.granted_bus_current_uA());
            }
        });

    // keyboard layout localization, using country code and extended attributes
    auto& kb_attrs = simple_keyboard::instance().attributes;
    kb_attrs.form_factor = hid::app::keyboard::form_factor::FULL_SIZE;
    kb_attrs.key_type = hid::app::keyboard::key_type::FULL_TRAVEL;
    kb_attrs.layout = hid::app::keyboard::layout::_102;

    static constexpr auto custom_strings = c2usb::make_reference_array<const char>("hu-hu");

    static usb::df::hid::string_function usb_kb{simple_keyboard::instance(), "keyboard",
                                                custom_strings, hid::boot::mode::KEYBOARD,
                                                usb::hid::country_code::HUNGARY};

    // define configurations and start device
    {
        using namespace std::chrono_literals;
        using namespace usb::df::config;
        constexpr auto speed = usb::speed::FULL;
        const auto config_header =
            header(power::bus(100, remote_wakeup), magic_enum::enum_name(speed).data());

        static const auto cfg = make_config(
            config_header, usb_kb.config_entry(speed, usb::endpoint::address(0x81),
                                               usb::endpoint::interval::from_rate(speed, 4ms)
#if CONFIG_DEMO_USB_HID_OUT_EP
                                                   ,
                                               usb::endpoint::address(0x01),
                                               usb::endpoint::interval::from_rate(speed, 16ms)
#endif
                                                   ));
        device().set_config(cfg);

        // string indexes are finalized by the last set_config... call
        kb_attrs.ietf_lang_tag_index = usb_kb.string_index(0);
    }
    device().open();

    while (true)
    {
        auto msg = input_msgq().get();
        if ((msg.value) && device().power_state() == usb::power::state::L2_SUSPEND)
        {
            device().remote_wakeup();
        }
        switch (msg.code)
        {
        case INPUT_KEY_0:
            simple_keyboard::instance().send_key(hid::page::keyboard_keypad::KEYBOARD_CAPS_LOCK,
                                                 msg.value);
            break;
        case INPUT_KEY_1:
            simple_keyboard::instance().send_key(
                hid::page::keyboard_keypad::KEYBOARD_BACKSLASH_PIPE, msg.value);
            break;
        case INPUT_KEY_2:
            simple_keyboard::instance().send_key(hid::page::keyboard_keypad::KEYBOARD_ENTER,
                                                 msg.value);
            break;
        case INPUT_KEY_3:
            simple_keyboard::instance().send_key(hid::page::keyboard_keypad::KEYBOARD_F1,
                                                 msg.value);
            break;
        default:
            break;
        }
    }
}
```
