## CMakeLists.txt
```
cmake_minimum_required(VERSION 3.20.0)
find_package(Zephyr REQUIRED HINTS $ENV{ZEPHYR_BASE})
project(c2usb_i2c_hid_target_loopback)

# the I2C HID device supports a single application, each one is tested in its own build
target_sources_ifdef(CONFIG_TEST_I2C_HID_APP_KEYBOARD app PRIVATE src/keyboard_tests.cpp)
target_sources_ifdef(CONFIG_TEST_I2C_HID_APP_RECORDING app PRIVATE src/app_tests.cpp)
```

## Kconfig
```
# SPDX-License-Identifier: Apache-2.0

choice TEST_I2C_HID_APP
    prompt "HID application under test"
    default TEST_I2C_HID_APP_KEYBOARD

config TEST_I2C_HID_APP_KEYBOARD
    bool "simple_keyboard: typical use, Linux i2c-hid boot sequence"

config TEST_I2C_HID_APP_RECORDING
    bool "recording test application: session and transport interactions"

endchoice

source "Kconfig.zephyr"
```

## prj.conf
```kconfig
CONFIG_ZTEST=y
CONFIG_ZTEST_STACK_SIZE=2048

CONFIG_GPIO=y
# the controller side, using the Zephyr STM32 I2C driver (DMA is enabled by the dmas property)
CONFIG_I2C=y

CONFIG_C2USB=y
CONFIG_C2USB_I2C_HID=y

CONFIG_ASSERT=y
CONFIG_SIZE_OPTIMIZATIONS=y
```

## boards/nucleo_l476rg.overlay
```dts
/* SPDX-License-Identifier: Apache-2.0 */

/* I2C bus pins are exposed on the Arduino connector.
 *
 *  Bus        SDA              SCL
 *          Pin   Hdr        Pin   Hdr
 *  i2c3    PC1   A4         PC0   A5      controller (Zephyr I2C driver, DMA)
 *  i2c1    PB9   D14        PB8   D15     target (c2usb HAL I2C driver, DMA)
 *
 * Short Pin PC1 to PB9, and PC0 to PB8, for the test to pass.
 * The internal pull-ups of the pins are enabled, external 4.7k pull-ups are recommended.
 * The I2C HID interrupt line (PA8) is read back by the test, it needs no wiring.
 */

/* the controller and target must use compatible bus timing */
#define I2C_TEST_TIMINGS <80000000 I2C_BITRATE_STANDARD 0x10909CEC>

i2c_test_controller: &i2c3 {
	clock-frequency = <I2C_BITRATE_STANDARD>;
	timings = I2C_TEST_TIMINGS;
	/* I2C3 requests: DMA1 channel 2 (TX) and 3 (RX), request 3 */
	dmas = <&dma1 2 3 (STM32_DMA_PERIPH_TX | STM32_DMA_PRIORITY_HIGH)>,
	       <&dma1 3 3 (STM32_DMA_PERIPH_RX | STM32_DMA_PRIORITY_HIGH)>;
	dma-names = "tx", "rx";
};

&i2c1 {
	compatible = "c2usb,stm32-i2c-v2-target";
	clock-frequency = <I2C_BITRATE_STANDARD>;
	timings = I2C_TEST_TIMINGS;
	/* I2C1 requests: DMA1 channel 6 (TX) and 7 (RX), request 3 */
	dmas = <&dma1 6 3 (STM32_DMA_PERIPH_TX | STM32_DMA_PRIORITY_HIGH)>,
	       <&dma1 7 3 (STM32_DMA_PERIPH_RX | STM32_DMA_PRIORITY_HIGH)>;
	dma-names = "tx", "rx";
	status = "okay";

	i2c_hid: hid@2c {
		compatible = "hid-over-i2c";
		reg = <0x2c>;
		hid-descr-addr = <0x0020>;
		int-gpios = <&gpioa 8 GPIO_ACTIVE_LOW>;
	};
};

&dma1 {
	status = "okay";
};
```

## src/i2c_hid_host.hpp
```c
// SPDX-License-Identifier: Apache-2.0
/*
 * HID over I2C loopback test:
 * two I2C peripherals of the chip are shorted, one is operated as the c2usb I2C HID device
 * (target, STM32 HAL driver with DMA), the other acts as the I2C HID host
 * (controller, Zephyr I2C driver with DMA).
 *
 * This header contains a minimal I2C HID host implementation, shared by the test applications.
 */
#pragma once

#include <zephyr/drivers/gpio.h>
#include <zephyr/drivers/i2c.h>
#include <zephyr/kernel.h>
#include <zephyr/ztest.h>

#include <algorithm>
#include <array>
#include <span>

#include <i2c/hid/device.hpp>
#include <i2c/vendor/stm32/zephyr_i2c_slave.hpp>

#define I2C_HID_NODE DT_NODELABEL(i2c_hid)
#define CONTROLLER_NODE DT_NODELABEL(i2c_test_controller)
BUILD_ASSERT(DT_ON_BUS(I2C_HID_NODE, i2c_target), "i2c_hid node must be on an I2C target bus");

namespace test
{
using c2usb::le_uint16_t;

constexpr uint16_t TEST_ADDRESS = DT_REG_ADDR(I2C_HID_NODE);
constexpr uint16_t HID_DESC_REGISTER = DT_PROP(I2C_HID_NODE, hid_descr_addr);
constexpr k_timeout_t INT_TIMEOUT = K_MSEC(100);

inline const device* const controller = DEVICE_DT_GET(CONTROLLER_NODE);
inline const gpio_dt_spec int_pin = GPIO_DT_SPEC_GET(I2C_HID_NODE, int_gpios);

// I2C HID bus messages, as defined by the HID over I2C specification

/// @brief  Register address, written before reading a register's content.
struct register_request
{
    le_uint16_t reg;
};

/// @brief  Command without data.
struct command_request
{
    le_uint16_t command_register;
    i2c::hid::command<> command;
};

/// @brief  Command, followed by reading the data register.
template <::hid::report::id::type REPORT_ID>
struct data_command_request
{
    le_uint16_t command_register;
    i2c::hid::command<REPORT_ID> command;
    le_uint16_t data_register;
};

/// @brief  Report data with its length prefix, the length includes the prefix itself.
template <typename T>
struct report_data
{
    le_uint16_t length{sizeof(report_data)};
    T report{};
};

/// @brief  Command, followed by writing the data register.
template <typename T>
struct set_report_request
{
    le_uint16_t command_register;
    i2c::hid::command<T::ID> command;
    le_uint16_t data_register;
    report_data<T> data;
};

/// @brief  Output report written to the output register.
template <typename T>
struct output_request
{
    le_uint16_t output_register;
    report_data<T> data;
};

template <typename T>
std::span<const uint8_t> as_bytes(const T& obj)
{
    // hid-rp reports with a report ID aren't standard layout (the ID is in their base class),
    // so view the object representation, which is well-defined for trivially copyable types
    static_assert(std::is_trivially_copyable_v<T> and (alignof(T) == 1),
                  "bus messages must be packed, trivially copyable types");
    // NOLINTNEXTLINE(*-type-reinterpret-cast)
    return {reinterpret_cast<const uint8_t*>(&obj), sizeof(T)};
}

template <typename T>
std::span<uint8_t> as_writable_bytes(T& obj)
{
    static_assert(std::is_trivially_copyable_v<T> and (alignof(T) == 1),
                  "bus messages must be packed, trivially copyable types");
    // NOLINTNEXTLINE(*-type-reinterpret-cast)
    return {reinterpret_cast<uint8_t*>(&obj), sizeof(T)};
}

inline bool all_padding(std::span<const uint8_t> data)
{
    return std::ranges::all_of(data, [](uint8_t b) { return b == 0xff; });
}

/// @brief  Minimal I2C HID host implementation, on top of the Zephyr I2C controller API.
class hid_host
{
  public:
    template <typename T>
    static int write(const T& request)
    {
        auto data = as_bytes(request);
        return i2c_write(controller, data.data(), data.size(), TEST_ADDRESS);
    }

    /// @brief  Plain read, without register address: reads the input register.
    template <typename T>
    static int read(T& response)
    {
        auto data = as_writable_bytes(response);
        return i2c_read(controller, data.data(), data.size(), TEST_ADDRESS);
    }

    template <typename TReq, typename TResp>
    static int write_read(const TReq& request, TResp& response)
    {
        auto req = as_bytes(request);
        auto resp = as_writable_bytes(response);
        return i2c_write_read(controller, TEST_ADDRESS, req.data(), req.size(), resp.data(),
                              resp.size());
    }

    int read_hid_descriptor(i2c::hid::descriptor& desc)
    {
        int ret = write_read(register_request{HID_DESC_REGISTER}, desc);
        if (ret == 0)
        {
            desc_ = desc;
        }
        return ret;
    }

    template <typename T>
    int read_register(uint16_t reg, T& response)
    {
        return write_read(register_request{reg}, response);
    }

    int command(const i2c::hid::command<>& cmd)
    {
        return write(command_request{desc_.wCommandRegister, cmd});
    }

    /// @brief  GET_REPORT command for the report type T, in short or extended format
    ///         depending on its report ID.
    template <typename T>
    int get_report(report_data<T>& response)
    {
        return write_read(data_command_request<T::ID>{desc_.wCommandRegister,
                                                      i2c::hid::command<T::ID>(
                                                          i2c::hid::opcode::GET_REPORT, T::type()),
                                                      desc_.wDataRegister},
                          response);
    }

    /// @brief  SET_REPORT command for the report type T, in short or extended format
    ///         depending on its report ID.
    template <typename T>
    int set_report(const T& report)
    {
        return write(
            set_report_request<T>{desc_.wCommandRegister,
                                  i2c::hid::command<T::ID>(i2c::hid::opcode::SET_REPORT, T::type()),
                                  desc_.wDataRegister, report_data<T>{.report = report}});
    }

    template <typename T>
    int write_output(const T& report)
    {
        return write(output_request<T>{desc_.wOutputRegister, report_data<T>{.report = report}});
    }

    static bool int_asserted() { return gpio_pin_get_dt(&int_pin) > 0; }

    static bool wait_int(bool asserted, k_timeout_t timeout = INT_TIMEOUT)
    {
        k_timepoint_t end = sys_timepoint_calc(timeout);
        while (int_asserted() != asserted)
        {
            if (sys_timepoint_expired(end))
            {
                return false;
            }
            k_sleep(K_TICKS(1));
        }
        return true;
    }

    /// @brief  Performs the host side reset sequence, as done at enumeration.
    void reset()
    {
        zassert_ok(command(i2c::hid::command<>(i2c::hid::opcode::RESET)));
        zassert_true(wait_int(true), "INT not asserted after RESET");

        // the reset response is a zero length (sentinel) in the input register
        le_uint16_t sentinel{0xaaaa};
        zassert_ok(read(sentinel));
        zassert_equal(sentinel, 0, "invalid reset response");
        zassert_true(wait_int(false), "INT not deasserted after reset response");
    }

    /// @brief  Reads the HID descriptor and resets the device, as a host does at enumeration.
    void enumerate()
    {
        i2c::hid::descriptor desc{};
        zassert_ok(read_hid_descriptor(desc));
        reset();
    }

    [[nodiscard]] const i2c::hid::descriptor& descriptor() const { return desc_; }

  private:
    i2c::hid::descriptor desc_{};
};

/// @brief  Prepares the controller side of the bus.
inline void setup_bus()
{
    zassert_true(device_is_ready(controller), "I2C controller not ready");
    zassert_not_null(C2USB_I2C_SLAVE_DT_GET(I2C_HID_NODE), "I2C target driver not ready");
    zassert_ok(i2c_configure(controller, I2C_MODE_CONTROLLER | I2C_SPEED_SET(I2C_SPEED_STANDARD)));
}

/// @brief  Creates the I2C HID device for the application, once.
template <typename TApp>
i2c::hid::device& hid_device(TApp& app, const i2c::hid::product_info& pinfo)
{
    static auto buffer = i2c::hid::device::make_buffer<TApp::report_protocol>();
    static i2c::hid::device dev{app,
                                pinfo,
                                *C2USB_I2C_SLAVE_DT_GET(I2C_HID_NODE),
                                C2USB_I2C_HID_DT_ADDRESS(I2C_HID_NODE),
                                C2USB_I2C_HID_DT_DESCRIPTOR_REG(I2C_HID_NODE),
                                buffer};
    return dev;
}

} // namespace test
```

## src/keyboard_tests.cpp
```c
// SPDX-License-Identifier: Apache-2.0
/*
 * I2C HID loopback tests with the simple_keyboard application:
 * typical keyboard use, and the Linux i2c-hid driver's device bring-up sequence.
 */
#include "i2c_hid_host.hpp"

#include <atomic>

#include <hid/example/simple_keyboard.hpp>

using keyboard_keypad = hid::page::keyboard_keypad;
using namespace test;

namespace
{
constexpr i2c::hid::product_info product_info{0x2fe3, 0x1202, i2c::hid::version("1.0")};

K_SEM_DEFINE(leds_sem, 0, 1);
std::atomic<uint8_t> last_leds{};

using keys_report = simple_keyboard::keys_report;
using leds_report = simple_keyboard::kb_leds_report;
using attributes_report = simple_keyboard::attributes_report;

hid_host host;

/// @brief  Sends a key state change from the application side, the session is created
///         asynchronously in the target ISR at reset completion.
c2usb::result send_key(keyboard_keypad key, bool pressed)
{
    k_timepoint_t end = sys_timepoint_calc(K_MSEC(10));
    auto result = simple_keyboard::instance().send_key(key, pressed);
    while ((result == c2usb::result::not_connected) and !sys_timepoint_expired(end))
    {
        k_sleep(K_TICKS(1));
        result = simple_keyboard::instance().send_key(key, pressed);
    }
    return result;
}

/// @brief  Waits for the input report triggered by the application, reads it and checks
///         the key's state in it.
void read_key_report(keyboard_keypad key, bool pressed)
{
    report_data<keys_report> input{.length = 0};

    zassert_true(hid_host::wait_int(true), "INT not asserted for input report");
    zassert_ok(hid_host::read(input));
    zassert_equal(input.length, sizeof(input), "unexpected input report length %u",
                  static_cast<unsigned>(input.length));
    zassert_true(hid_host::wait_int(false), "INT not deasserted after input report");
    zassert_equal(input.report.scancodes.test(key), pressed, "key 0x%02x state mismatch",
                  static_cast<unsigned>(key));
}

void leds_callback(keyboard_leds_data leds)
{
    last_leds.store(leds.test(hid::page::leds::CAPS_LOCK) ? 1 : 0);
    k_sem_give(&leds_sem);
}

leds_report caps_lock_leds(bool on)
{
    leds_report report{};
    report.leds.set(hid::page::leds::CAPS_LOCK, on);
    return report;
}

void* suite_setup()
{
    setup_bus();
    simple_keyboard::instance().set_leds_callback(leds_callback);
    hid_device(simple_keyboard::instance(), product_info);
    return nullptr;
}

void before_each(void*)
{
    // enumerate the device as a host would
    host.enumerate();
    k_sem_reset(&leds_sem);
}

void after_each(void*)
{
    // leave no key pressed behind, which would show up in the next test's first report
    if (simple_keyboard::instance().send_key(keyboard_keypad::KEYBOARD_CAPS_LOCK, false) ==
        c2usb::result::ok)
    {
        if (hid_host::wait_int(true))
        {
            report_data<keys_report> input{};
            (void)hid_host::read(input);
        }
    }
}
} // namespace

ZTEST_SUITE(i2c_hid_loopback, nullptr, suite_setup, before_each, after_each, nullptr);

ZTEST(i2c_hid_loopback, test_hid_descriptor)
{
    const auto& desc = host.descriptor();
    const auto& rp = simple_keyboard::instance().report_info();

    zassert_equal(desc.wHIDDescLength, sizeof(i2c::hid::descriptor));
    zassert_equal(desc.bcdVersion, i2c::hid::SPEC_VERSION);
    zassert_equal(desc.wReportDescLength, rp.descriptor.size());
    zassert_equal(desc.wMaxInputLength, sizeof(report_data<keys_report>));
    zassert_equal(desc.wMaxOutputLength, sizeof(report_data<leds_report>));
    zassert_equal(desc.wVendorID, product_info.vendor_id);
    zassert_equal(desc.wProductID, product_info.product_id);
    zassert_equal(desc.wVersionID, product_info.product_version);

    // registers must be distinct, and differ from the HID descriptor register
    const std::array<uint16_t, 6> regs{HID_DESC_REGISTER,     desc.wReportDescRegister,
                                       desc.wInputRegister,   desc.wOutputRegister,
                                       desc.wCommandRegister, desc.wDataRegister};
    for (size_t i = 0; i < regs.size(); ++i)
    {
        for (size_t j = i + 1; j < regs.size(); ++j)
        {
            zassert_not_equal(regs[i], regs[j], "register %zu and %zu collide", i, j);
        }
    }
}

ZTEST(i2c_hid_loopback, test_report_descriptor)
{
    const auto& desc = host.descriptor();
    const auto expected = simple_keyboard::instance().report_info().descriptor.to_span();

    std::array<uint8_t, 128> buf{};
    zassert_true(expected.size() <= buf.size());
    zassert_ok(i2c_write_read(controller, TEST_ADDRESS,
                              as_bytes(register_request{desc.wReportDescRegister}).data(),
                              sizeof(register_request), buf.data(), expected.size()));
    zassert_mem_equal(buf.data(), expected.data(), expected.size());
}

ZTEST(i2c_hid_loopback, test_repeated_reset)
{
    // before_each() has already done a full reset
    for (int i = 0; i < 3; ++i)
    {
        host.reset();
    }
}

ZTEST(i2c_hid_loopback, test_input_report)
{
    zassert_equal(send_key(keyboard_keypad::KEYBOARD_CAPS_LOCK, true), c2usb::result::ok);
    read_key_report(keyboard_keypad::KEYBOARD_CAPS_LOCK, true);

    zassert_equal(send_key(keyboard_keypad::KEYBOARD_CAPS_LOCK, false), c2usb::result::ok);
    read_key_report(keyboard_keypad::KEYBOARD_CAPS_LOCK, false);

    zassert_false(hid_host::int_asserted(), "INT asserted without pending report");
}

ZTEST(i2c_hid_loopback, test_input_report_busy)
{
    // a single report can be pending, until the host reads it
    zassert_equal(send_key(keyboard_keypad::KEYBOARD_CAPS_LOCK, true), c2usb::result::ok);
    zassert_true(hid_host::wait_int(true));
    zassert_equal(simple_keyboard::instance().send_key(keyboard_keypad::KEYBOARD_ENTER, true),
                  c2usb::result::device_or_resource_busy,
                  "second report accepted while the first is pending");

    // the pending report is delivered, the refused one isn't sent
    // (its key state is still recorded in the keyboard's report buffer)
    read_key_report(keyboard_keypad::KEYBOARD_CAPS_LOCK, true);
    zassert_false(hid_host::int_asserted(), "refused report was queued");

    // once delivered, the next report is accepted
    zassert_equal(send_key(keyboard_keypad::KEYBOARD_ENTER, false), c2usb::result::ok);
    read_key_report(keyboard_keypad::KEYBOARD_ENTER, false);
}

ZTEST(i2c_hid_loopback, test_input_read_beyond_report)
{
    // reading more than the report, the device sends padding until the controller NACKs
    struct
    {
        report_data<keys_report> input{.length = 0};
        std::array<uint8_t, 12> padding{};
    } oversized_read;

    zassert_equal(send_key(keyboard_keypad::KEYBOARD_ENTER, true), c2usb::result::ok);
    zassert_true(hid_host::wait_int(true));
    zassert_ok(hid_host::read(oversized_read));
    zassert_equal(oversized_read.input.length, sizeof(oversized_read.input));
    zassert_true(oversized_read.input.report.scancodes.test(keyboard_keypad::KEYBOARD_ENTER));
    zassert_true(std::ranges::all_of(oversized_read.padding, [](uint8_t b) { return b == 0xff; }),
                 "unexpected padding content");
    zassert_true(hid_host::wait_int(false));

    // the device remains functional
    zassert_equal(send_key(keyboard_keypad::KEYBOARD_ENTER, false), c2usb::result::ok);
    read_key_report(keyboard_keypad::KEYBOARD_ENTER, false);
}

ZTEST(i2c_hid_loopback, test_output_report)
{
    zassert_ok(host.write_output(caps_lock_leds(true)));
    zassert_ok(k_sem_take(&leds_sem, K_MSEC(100)), "output report not received");
    zassert_equal(last_leds.load(), 1);

    zassert_ok(host.write_output(caps_lock_leds(false)));
    zassert_ok(k_sem_take(&leds_sem, K_MSEC(100)), "output report not received");
    zassert_equal(last_leds.load(), 0);
}

ZTEST(i2c_hid_loopback, test_set_report_command)
{
    zassert_ok(host.set_report(caps_lock_leds(true)));
    zassert_ok(k_sem_take(&leds_sem, K_MSEC(100)), "SET_REPORT not received");
    zassert_equal(last_leds.load(), 1);
}

ZTEST(i2c_hid_loopback, test_get_report_command)
{
    // input report, nothing pressed
    report_data<keys_report> input{.length = 0};
    input.report.scancodes.set(keyboard_keypad::KEYBOARD_A);
    zassert_ok(host.get_report(input));
    zassert_equal(input.length, sizeof(input));
    const keys_report no_keys{};
    zassert_mem_equal(&input.report, &no_keys, sizeof(keys_report),
                      "unexpected input report content");

    // feature report: keyboard attributes
    auto& attrs = simple_keyboard::instance().attributes;
    attrs.layout = hid::app::keyboard::layout::_102;
    report_data<attributes_report> feature{.length = 0};
    zassert_ok(host.get_report(feature));
    zassert_equal(feature.length, sizeof(feature));
    zassert_mem_equal(&feature.report, &attrs, sizeof(attributes_report));
}

ZTEST(i2c_hid_loopback, test_set_power)
{
    zassert_ok(host.command(i2c::hid::command<0>(i2c::hid::opcode::SET_POWER, true)));  // sleep
    zassert_ok(host.command(i2c::hid::command<0>(i2c::hid::opcode::SET_POWER, false))); // on

    zassert_equal(send_key(keyboard_keypad::KEYBOARD_CAPS_LOCK, true), c2usb::result::ok);
    read_key_report(keyboard_keypad::KEYBOARD_CAPS_LOCK, true);
}

ZTEST(i2c_hid_loopback, test_invalid_register_read)
{
    // an unknown register is rejected, the device sends padding instead of data
    std::array<uint8_t, 4> buf{};
    zassert_ok(host.read_register(0x1234, buf));
    zassert_true(std::ranges::all_of(buf, [](uint8_t b) { return b == 0xff; }),
                 "unexpected data from invalid register");

    // the device remains functional
    i2c::hid::descriptor desc{};
    zassert_ok(host.read_hid_descriptor(desc));
    zassert_equal(desc.wHIDDescLength, sizeof(i2c::hid::descriptor));
}

ZTEST(i2c_hid_loopback, test_other_address_nack)
{
    le_uint16_t buf{};
    zassert_not_ok(
        i2c_read(controller, as_writable_bytes(buf).data(), sizeof(buf), TEST_ADDRESS + 1),
        "transfer to another address was acknowledged");

    // the device remains functional
    i2c::hid::descriptor desc{};
    zassert_ok(host.read_hid_descriptor(desc));
}

ZTEST(i2c_hid_loopback, test_stress)
{
    constexpr int ITERATIONS = 200;
    for (int i = 0; i < ITERATIONS; ++i)
    {
        zassert_equal(send_key(keyboard_keypad::KEYBOARD_CAPS_LOCK, true), c2usb::result::ok);
        read_key_report(keyboard_keypad::KEYBOARD_CAPS_LOCK, true);
        zassert_equal(send_key(keyboard_keypad::KEYBOARD_CAPS_LOCK, false), c2usb::result::ok);
        read_key_report(keyboard_keypad::KEYBOARD_CAPS_LOCK, false);

        // interleave controller initiated transfers
        if ((i % 16) == 0)
        {
            i2c::hid::descriptor desc{};
            zassert_ok(host.read_hid_descriptor(desc));
            zassert_equal(desc.wVendorID, product_info.vendor_id);
        }
    }
}

/*
 * Full device bring-up, following the sequence of the Linux i2c-hid driver
 * (drivers/hid/i2c-hid/i2c-hid-core.c) at probe and when the HID device is opened.
 * This suite has no per-test reset, the device is taken in whatever state it's in,
 * as at a driver (re)bind.
 */
ZTEST_SUITE(i2c_hid_linux_boot, nullptr, suite_setup, nullptr, nullptr, nullptr);

ZTEST(i2c_hid_linux_boot, test_boot_sequence)
{
    // i2c_hid_probe_address(): presence check with a single byte read (i2c_smbus_read_byte()),
    // the device answers with the empty input register
    uint8_t presence = 0xaa;
    zassert_ok(i2c_read(controller, &presence, sizeof(presence), TEST_ADDRESS),
               "device not present on the bus");
    zassert_equal(presence, 0, "unexpected presence check data");

    // i2c_hid_fetch_hid_descriptor(): read and validate the HID descriptor
    i2c::hid::descriptor desc{};
    zassert_ok(host.read_hid_descriptor(desc));
    zassert_equal(desc.bcdVersion, i2c::hid::SPEC_VERSION, "unsupported HID descriptor version");
    zassert_equal(desc.wHIDDescLength, sizeof(i2c::hid::descriptor),
                  "unexpected HID descriptor length");

    // i2c_hid_start_hwreset(): power on, then reset
    zassert_ok(host.command(i2c::hid::command<0>(i2c::hid::opcode::SET_POWER, false)));
    zassert_ok(host.command(i2c::hid::command<0>(i2c::hid::opcode::RESET)));

    // i2c_hid_finish_hwreset(): the reset completes when the interrupt handler
    // reads a zero length input (i2c_hid_get_input() always reads wMaxInputLength)
    zassert_true(hid_host::wait_int(true), "INT not asserted after RESET");
    struct
    {
        le_uint16_t length{0xaaaa};
        std::array<uint8_t, sizeof(keys_report)> rest{};
    } reset_response;
    zassert_equal(sizeof(reset_response), desc.wMaxInputLength);
    zassert_ok(hid_host::read(reset_response));
    zassert_equal(reset_response.length, 0, "invalid reset response");
    zassert_true(hid_host::wait_int(false), "INT not deasserted after reset response");

    // i2c_hid_parse(): read the report descriptor
    const auto expected = simple_keyboard::instance().report_info().descriptor.to_span();
    std::array<uint8_t, 128> rdesc{};
    zassert_true(desc.wReportDescLength <= rdesc.size());
    zassert_equal(desc.wReportDescLength, expected.size());
    zassert_ok(i2c_write_read(controller, TEST_ADDRESS,
                              as_bytes(register_request{desc.wReportDescRegister}).data(),
                              sizeof(register_request), rdesc.data(), desc.wReportDescLength));
    zassert_mem_equal(rdesc.data(), expected.data(), expected.size());

    // hid core initializes the feature reports with GET_REPORT
    report_data<attributes_report> feature{.length = 0};
    zassert_ok(host.get_report(feature));
    zassert_equal(feature.length, sizeof(feature));
    zassert_mem_equal(&feature.report, &simple_keyboard::instance().attributes,
                      sizeof(attributes_report));

    // i2c_hid_open() -> hid-input syncs the keyboard LED state via the output register
    k_sem_reset(&leds_sem);
    zassert_ok(host.write_output(caps_lock_leds(false)));
    zassert_ok(k_sem_take(&leds_sem, K_MSEC(100)), "LED output report not received");
    zassert_equal(last_leds.load(), 0);

    // the interrupt handler reads input reports
    zassert_false(hid_host::int_asserted(), "INT asserted without pending report");
    zassert_equal(send_key(keyboard_keypad::KEYBOARD_CAPS_LOCK, true), c2usb::result::ok);
    read_key_report(keyboard_keypad::KEYBOARD_CAPS_LOCK, true);

    // the host reacts with an LED update
    zassert_ok(host.write_output(caps_lock_leds(true)));
    zassert_ok(k_sem_take(&leds_sem, K_MSEC(100)), "LED output report not received");
    zassert_equal(last_leds.load(), 1);

    zassert_equal(send_key(keyboard_keypad::KEYBOARD_CAPS_LOCK, false), c2usb::result::ok);
    read_key_report(keyboard_keypad::KEYBOARD_CAPS_LOCK, false);

    // i2c_hid_core_suspend() / i2c_hid_core_resume(): power state changes
    zassert_ok(host.command(i2c::hid::command<0>(i2c::hid::opcode::SET_POWER, true)));
    zassert_ok(host.command(i2c::hid::command<0>(i2c::hid::opcode::SET_POWER, false)));
    zassert_equal(send_key(keyboard_keypad::KEYBOARD_A, true), c2usb::result::ok);
    read_key_report(keyboard_keypad::KEYBOARD_A, true);
    zassert_equal(send_key(keyboard_keypad::KEYBOARD_A, false), c2usb::result::ok);
    read_key_report(keyboard_keypad::KEYBOARD_A, false);

    zassert_false(hid_host::int_asserted(), "INT asserted without pending report");
}
```
