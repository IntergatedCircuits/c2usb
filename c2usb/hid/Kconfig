## c2usb/hid/Kconfig
```kconfig
menu "c2usb HID configuration"

config C2USB_HID_BOOT_PROTOCOL
    bool "c2usb HID boot protocol support"
    default n
    help
      This option enables support for the HID boot protocol in the supported transports (BLE, USB),
      allowing the creation of boot protocol compliant keyboard and mouse devices.

endmenu
```

## c2usb/i2c/Kconfig
```kconfig
menuconfig C2USB_I2C_HID
	bool "c2usb HID over I2C"
    select C2USB

if C2USB_I2C_HID

    config C2USB_I2C_HID_FULL_COMMAND_SUPPORT
        bool "c2usb HID over I2C full command support"
        default n
        help
          This option enables I2C HID commands that aren't used in practice (SET_IDLE, SET_PROTOCOL).

endif
```

## c2usb/port/nxp/Kconfig
```kconfig
config C2USB_MCUX_MAC
	bool "c2usb MCUX MAC driver"
	select C2USB
	select MCUX_MISC_USB_LITE
	select MCUX_COMPONENT_middleware.usb.common_header
	select MCUX_COMPONENT_middleware.usb.device.common_header

if C2USB_MCUX_MAC

	config C2USB_MCUX_USB_COEXISTENCE
	bool "c2usb coexistence with MCUX USB stack"
	help
	  This option allows runtime coexistence between the c2usb and the MCUX USB stack.
	  You must patch usb_device_dci.c: USB_DeviceNotificationTrigger -> _USB_DeviceNotificationTrigger

endif
```

## c2usb/port/zephyr/Kconfig
```kconfig
rsource "bluetooth/Kconfig"

menuconfig C2USB_UDC_MAC
	bool "c2usb UDC MAC driver"
	select UDC_DRIVER
	select C2USB

if C2USB_UDC_MAC

module = C2USB_UDC_MAC
module-str = c2usb UDC MAC
source "subsys/logging/Kconfig.template.log_config"

config C2USB_UDC_MAC_MSGQ_SIZE
	int "Size of message queue receiving events from Zephyr UDC driver."
	range 4 40
	default 10

config C2USB_UDC_MAC_THREAD_STACK_SIZE
	int "UDC MAC thread stack size"
	default 1024

config C2USB_UDC_MAC_BUF_POOL_RESERVE
	int "UDC buf pool reserve that is not to be allocated by UDC MAC"
	range 96 192
	default 128

endif # C2USB_UDC_MAC

rsource "Kconfig.shell"
```

## c2usb/port/zephyr/bluetooth/Kconfig
```kconfig
menuconfig C2USB_BLUETOOTH
	bool "c2usb Bluetooth drivers"
	default n
	select BT_GATT_DYNAMIC_DB
	select CPP

if C2USB_BLUETOOTH

module = C2USB_HOGP
module-str = c2usb HID over GATT
source "subsys/logging/Kconfig.template.log_config"

endif # C2USB_BLUETOOTH
```

## zephyr/Kconfig.hwinfo
```kconfig
if HWINFO

config HWINFO_DEVICE_ID_LENGTH
    int "HW Info device ID length"
    default 8 if HWINFO_NRF
    default 16 if SOC_SERIES_IMXRT118X
    default 8 if SOC_SERIES_IMXRT10XX || SOC_SERIES_IMXRT11XX
    default 4 if HWINFO_NATIVE
    default 12 if HWINFO_STM32
    default 8 if HWINFO_RPI_PICO
    default 8 if HWINFO_MCUX_SIM # it's more complicated, but hard to express in Kconfig
    default 6

endif # HWINFO
```

## zephyr/examples/Kconfig
```kconfig
# SPDX-License-Identifier: Apache-2.0
menu "C2USB demo options"

config DEMO_MANUFACTURER
	string "USB/BLE device manufacturer string"
	default "Zephyr Project"

config DEMO_MANUFACTURER_ID
	hex "USB/BLE device manufacturer ID"
	default 0x2fe3

config DEMO_PRODUCT
	string "USB/BLE device product string"
	default "Demo Product"

config DEMO_PRODUCT_ID
	hex "USB/BLE device product ID"
	default 0x0001

config DEMO_USB_HID_OUT_EP
	bool "Enable USB HID OUT endpoint"
	default n
	help
	  Enable USB HID OUT endpoint for receiving data from host.
	  Otherwise OUT data is received through the control endpoint.

endmenu

configdefault USB_DEVICE_STACK_NEXT
    default n

# configdefaults must come before sourcing "Kconfig.zephyr" in order to give precedence
# to these application-specific defaults instead of the unconditional default in the Zephyr Kconfig tree.
source "Kconfig.zephyr"
```
