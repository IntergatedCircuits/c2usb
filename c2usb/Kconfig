## c2usb/bluetooth/Kconfig
```kconfig
menuconfig C2USB_HOGP
    bool "c2usb HID over GATT"
    depends on BT

if C2USB_HOGP

module = C2USB_HOGP
module-str = c2usb HID over GATT
source "subsys/logging/Kconfig.template.log_config"

config C2USB_HOGP_POWER_EVENT
    bool "Enable HOGP control point power event callback"

config C2USB_HOGP_SCI
    bool "Enable HID Shorter Connection Intervals (SCI) support"
    depends on BT_SHORTER_CONNECTION_INTERVALS

if C2USB_HOGP_SCI

config C2USB_HOGP_MAX_CONN_INTERVAL_GROUPS
    int "Maximum number of connection interval groups"
    default 4
    range 0 41

endif # C2USB_HOGP_SCI

endif # C2USB_HOGP
```

## c2usb/port/zephyr/Kconfig.shell
```kconfig
menuconfig SHELL_BACKEND_C2USB
    bool "c2usb shell backend"
    depends on SHELL
    help
      Build c2usb shell backend.

if SHELL_BACKEND_C2USB

config SHELL_PROMPT_C2USB
    string "Displayed prompt name"
    default "c2usb:~$ "
    help
      Displayed prompt name for c2usb backend. If prompt is set, the shell will
      send two newlines during initialization.

config SHELL_C2USB_FUNCTION_NAME
    string "Shell USB CDC function name"
    default ""
    help
      Name of the USB CDC function to use for the shell.

config SHELL_BACKEND_C2USB_TX_BUFFER_SIZE
    int "c2usb shell TX double buffer overall size"
    range 128 256
    default 256

config SHELL_BACKEND_C2USB_RX_BUFFER_SIZE
    int "c2usb shell RX double buffer overall size"
    range 32 128
    default 128

module = SHELL_BACKEND_C2USB
default-timeout = 100
source "subsys/shell/Kconfig.template.shell_log_queue_timeout"

default-size = 512
source "subsys/shell/Kconfig.template.shell_log_queue_size"

module-str = c2usb shell backend
source "subsys/logging/Kconfig.template.log_config"

endif # SHELL_BACKEND_C2USB
```

## c2usb/usb/df/vendor/zephyr/Kconfig
```kconfig
menuconfig C2USB_UDC_MAC
    bool "c2usb UDC MAC driver"
    select UDC_DRIVER
    select C2USB_DF

if C2USB_UDC_MAC

module = C2USB_UDC_MAC
module-str = c2usb UDC MAC
source "subsys/logging/Kconfig.template.log_config"

config C2USB_UDC_MAC_MSGQ_SIZE
    int "Size of message queue receiving events from Zephyr UDC driver."
    range 4 40
    default 10

config C2USB_UDC_MAC_THREAD_STACK_SIZE
    int "UDC MAC thread stack size"
    default 1024

config C2USB_UDC_MAC_INITIAL_POWER_OFF
    bool "Start the USB device in powered off state"
    default y if UDC_NRF || (UDC_DWC2 && SOC_FAMILY_NORDIC_NRF)
    help
      Start the USB device in L3_OFF power state, and only connect to the bus
      when the UDC driver reports Vbus presence. Ignored if the UDC driver
      cannot detect Vbus.
      Only enable this if the UDC driver reports Vbus that is already present at
      initialization, otherwise the device stays disconnected until Vbus is reapplied.
      If disabled, the device starts in L2_SUSPEND state and connects immediately.

endif # C2USB_UDC_MAC

rsource "Kconfig.cdc_ncm"
rsource "Kconfig.shell"
rsource "Kconfig.smp_console"
```

## c2usb/usb/df/vendor/zephyr/Kconfig.cdc_ncm
```kconfig
menuconfig C2USB_CDC_NCM_ETHERNET
    bool "c2usb CDC NCM Ethernet adapter"
    depends on NET_L2_ETHERNET
    select C2USB_DF
    help
        Build the Zephyr Ethernet adapter for c2usb CDC NCM functions.

if C2USB_CDC_NCM_ETHERNET

config C2USB_CDC_NCM_ETHERNET_PROMISC_MODE
    bool "c2usb CDC NCM Ethernet promiscuous mode"

module = C2USB_CDC_NCM_ETHERNET
module-str = c2usb CDC NCM Ethernet adapter
source "subsys/logging/Kconfig.template.log_config"

endif # C2USB_CDC_NCM_ETHERNET
```

## c2usb/usb/df/vendor/zephyr/Kconfig.shell
```kconfig
menuconfig C2USB_SHELL_BACKEND
    bool "c2usb shell backend"
    depends on SHELL
    help
      Build c2usb shell backend.

if C2USB_SHELL_BACKEND

config C2USB_SHELL_PROMPT
    string "Displayed prompt name"
    default "c2usb:~$ "
    help
      Displayed prompt name for c2usb backend. If prompt is set, the shell will
      send two newlines during initialization.

config SHELL_C2USB_FUNCTION_NAME
    string "Shell USB CDC function name"
    default ""
    help
      Name of the USB CDC function to use for the shell.

config C2USB_SHELL_BACKEND_TX_BUFFER_SIZE
    int "c2usb shell TX double buffer overall size"
    range 128 1024
    default 1024 if UDC_DRIVER_HIGH_SPEED_SUPPORT_ENABLED
    default 128

config C2USB_SHELL_BACKEND_RX_BUFFER_SIZE
    int "c2usb shell RX double buffer overall size"
    range 32 1024
    default 1024 if UDC_DRIVER_HIGH_SPEED_SUPPORT_ENABLED
    default 128

module = C2USB_SHELL_BACKEND
default-timeout = 100
source "subsys/shell/Kconfig.template.shell_log_queue_timeout"

default-size = 512
source "subsys/shell/Kconfig.template.shell_log_queue_size"

module-str = c2usb shell backend
source "subsys/logging/Kconfig.template.log_config"

endif # C2USB_SHELL_BACKEND
```

## c2usb/usb/df/vendor/zephyr/Kconfig.smp_console
```kconfig
menuconfig C2USB_MCUMGR_SMP_CONSOLE
    bool "c2usb MCUmgr SMP over CDC ACM console transport"
    depends on MCUMGR
    depends on BASE64
    depends on CRC
    select MCUMGR_TRANSPORT_SERIAL_HAS_SMP_OVER_CONSOLE
    help
      Enables a dedicated CDC ACM function for MCUmgr SMP serial transport.

if C2USB_MCUMGR_SMP_CONSOLE

config C2USB_MCUMGR_SMP_CONSOLE_FUNCTION_NAME
    string "SMP console function name"
    default "MCUmgr SMP"

config C2USB_MCUMGR_SMP_CONSOLE_TX_BUFFER_SIZE
    int "SMP console TX double buffer overall size"
    range 128 1024
    default 512 if UDC_DRIVER_HIGH_SPEED_SUPPORT_ENABLED
    default 128

config C2USB_MCUMGR_SMP_CONSOLE_RX_BUFFER_SIZE
    int "SMP console RX buffer size"
    range 64 512
    default 512 if UDC_DRIVER_HIGH_SPEED_SUPPORT_ENABLED
    default 64

config C2USB_MCUMGR_SMP_CONSOLE_MTU
    int "SMP console MTU"
    default 256
    help
      Maximum size of SMP frames sent and received over CDC ACM. This value must satisfy the
      following relation: C2USB_MCUMGR_SMP_CONSOLE_MTU <= MCUMGR_TRANSPORT_NETBUF_SIZE + 2.

module = C2USB_MCUMGR_SMP_CONSOLE
module-str = c2usb SMP console
source "subsys/logging/Kconfig.template.log_config"

endif # C2USB_MCUMGR_SMP_CONSOLE
```

## mcux/Kconfig
```kconfig
menuconfig C2USB
    bool "c2usb library"
    select HID_RP

if C2USB

rsource "../c2usb/Kconfig"
rsource "../c2usb/port/nxp/Kconfig"

endif
```

## west.yml
```yaml
# This is the shared manifest file for west module use, regardless of SDK
manifest:
  self:
    path: c2usb
    west-commands: scripts/west-commands.yml
  defaults:
    remote: IntergatedCircuits

  remotes:
    - name: IntergatedCircuits
      url-base: https://github.com/IntergatedCircuits

  projects:
    - name: hid-rp
      revision: 08f367bf5335633ae80e694f296e224fdc518fe8
      import:
        path-prefix: modules/lib

    - name: zephyrrtos-mcpp
      revision: 764060708b9a5bf26c07da27363b2325309d54bc
      groups: [zephyr]
      path: modules/lib/zephyrrtos-mcpp

    - name: freertos-mcpp
      revision: 31e7c17d7d174d5901c5b0e53f999ea0540a30f3
      groups: [mcux]
      path: modules/lib/freertos-mcpp

    - name: etl
      url: https://github.com/ETLCPP/etl
      revision: 20.49.0
      clone-depth: 1
      groups: [zephyr, mcux]
      path: modules/lib/etl
```

## zephyr/Kconfig
```kconfig
menuconfig C2USB
    bool "c2usb library"
    select CPP
    select REQUIRES_FULL_LIBCPP
    select HID_RP
    select ETL

if C2USB

rsource "../c2usb/Kconfig"
rsource "../c2usb/bluetooth/Kconfig"
rsource "../c2usb/usb/df/vendor/zephyr/Kconfig"

endif

rsource "Kconfig.hwinfo"

choice STD_CPP
    default STD_CPP20 if C2USB
endchoice

configdefault SHELL_STACK_SIZE
    default 1280 if SHELL_BACKEND_C2USB
```

## zephyr/dts/bindings/ethernet/c2usb,cdc-ncm-ethernet.yaml
```yaml
description: c2usb CDC NCM virtual Ethernet controller

compatible: "c2usb,cdc-ncm-ethernet"

include: base.yaml

properties:
  function-name:
    type: string
    required: false
    description: Name of the CDC NCM function associated with this virtual Ethernet controller.
```

## zephyr/tests/bluetooth/battery_service/testcase.yaml
```yaml
tests:
  c2usb.bluetooth.battery_service:
    platform_allow:
      - native_sim
      - native_sim/native/64
    integration_platforms:
      - native_sim/native/64
    tags:
      - bluetooth
      - c2usb
```

## zephyr/tests/usb/cdc_ncm_virtual/testcase.yaml
```yaml
tests:
  c2usb.usb.cdc_ncm_virtual:
    platform_allow:
      - native_sim
      - native_sim/native/64
    integration_platforms:
      - native_sim/native/64
    extra_configs:
      - CONFIG_COMPILER_WARNINGS_AS_ERRORS=n
    extra_args:
      - EXTRA_CXXFLAGS=-Wno-error
    tags:
      - usb
      - c2usb
      - net
```
