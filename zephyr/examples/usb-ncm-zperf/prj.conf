## CMakeLists.txt
```
# SPDX-License-Identifier: Apache-2.0

cmake_minimum_required(VERSION 3.20.0)
find_package(Zephyr REQUIRED HINTS $ENV{ZEPHYR_BASE})
project(usb-ncm)

target_sources(app PRIVATE src/main.cpp)

if(CONFIG_NET_SAMPLE_CODE_RELOCATE)
  # Relocate key networking stack components and L2 layer to RAM
  zephyr_code_relocate(LIBRARY subsys__net__ip
    LOCATION "${CONFIG_NET_SAMPLE_CODE_RAM_NAME}_TEXT" NOKEEP)
  zephyr_code_relocate(LIBRARY subsys__net
    LOCATION "${CONFIG_NET_SAMPLE_CODE_RAM_NAME}_TEXT" NOKEEP)
if(CONFIG_NET_L2_ETHERNET)
  zephyr_code_relocate(LIBRARY drivers__ethernet
    LOCATION "${CONFIG_NET_SAMPLE_CODE_RAM_NAME}_TEXT" NOKEEP)
  zephyr_code_relocate(LIBRARY subsys__net__l2__ethernet
    LOCATION "${CONFIG_NET_SAMPLE_CODE_RAM_NAME}_TEXT" NOKEEP)
endif()
endif()
```

## Kconfig
```
# SPDX-License-Identifier: Apache-2.0
rsource "../Kconfig"
```

## Kconfig.sysbuild
```
../../../../nrf/samples/bluetooth/peripheral_hids_keyboard/Kconfig.sysbuild
```

## sample.yaml
```
sample:
  description: c2usb CDC NCM virtual Ethernet performance measurement
  name: c2usb USB NCM zperf
tests:
  c2usb.usb-ncm-zperf:
    sysbuild: true
    integration_platforms:
      - nrf52840dk/nrf52840
      - nrf54lm20dk/nrf54lm20a/cpuapp
    platform_allow:
      - nrf52dk/nrf52832
      - nrf52840dk/nrf52840
      - nrf5340dk/nrf5340/cpuapp
      - nrf5340dk/nrf5340/cpuapp/ns
      - nrf54l15dk/nrf54l05/cpuapp
      - nrf54l15dk/nrf54l10/cpuapp
      - nrf54l15dk/nrf54l15/cpuapp
      - nrf54lm20dk/nrf54lm20a/cpuapp
      - nrf54lm20dk/nrf54lm20b/cpuapp
      - nrf54ls05dk/nrf54ls05b/cpuapp
      - nrf54lv10dk/nrf54lv10a/cpuapp
      - nrf54lv10dk/nrf54lv10a/cpuapp/ns
      - nrf54h20dk/nrf54h20/cpuapp
    tags:
      - usb
      - net
      - zperf
    harness: build
```

## prj.conf
```kconfig
CONFIG_LOG=y
CONFIG_HWINFO=y

CONFIG_UDC_DRIVER_LOG_LEVEL_WRN=y
CONFIG_C2USB=y
CONFIG_C2USB_UDC_MAC=y
CONFIG_C2USB_CDC_NCM_ETHERNET=y
CONFIG_C2USB_CDC_NCM_ETHERNET_LOG_LEVEL_DBG=y

CONFIG_MAIN_STACK_SIZE=2048
CONFIG_ISR_TABLES_LOCAL_DECLARATION=y
CONFIG_ASSERT=y
CONFIG_DEBUG_THREAD_INFO=y

CONFIG_NETWORKING=y
CONFIG_NET_ZPERF=y
CONFIG_NET_ZPERF_SERVER=y
CONFIG_NET_LOG=y
CONFIG_NET_IPV6=y
CONFIG_NET_IPV4=y
CONFIG_NET_DHCPV4=n
CONFIG_NET_UDP=y
CONFIG_NET_TCP=y
CONFIG_NET_TCP_IPV6_ND_REACHABILITY_HINT=y
CONFIG_NET_STATISTICS=y

CONFIG_NET_PKT_RX_COUNT=40
CONFIG_NET_PKT_TX_COUNT=40
CONFIG_NET_BUF_RX_COUNT=160
CONFIG_NET_BUF_TX_COUNT=160
CONFIG_NET_BUF_DATA_SIZE=256
CONFIG_NET_IF_UNICAST_IPV6_ADDR_COUNT=4
CONFIG_NET_IF_MCAST_IPV6_ADDR_COUNT=5
CONFIG_NET_IF_UNICAST_IPV4_ADDR_COUNT=1
CONFIG_NET_MAX_CONTEXTS=5
CONFIG_NET_TC_TX_COUNT=1
CONFIG_NET_SOCKETS=y
CONFIG_NET_SOCKETS_SERVICE_THREAD_PRIO=-1
CONFIG_ZVFS_POLL_MAX=9

CONFIG_INIT_STACKS=y
CONFIG_TEST_RANDOM_GENERATOR=y

CONFIG_NET_L2_ETHERNET=y
CONFIG_NET_SHELL=y

CONFIG_NET_CONFIG_SETTINGS=y
CONFIG_NET_CONFIG_AUTO_INIT=n
CONFIG_NET_CONFIG_MY_IPV6_ADDR="2001:db8::1"
CONFIG_NET_CONFIG_PEER_IPV6_ADDR="2001:db8::2"
CONFIG_NET_CONFIG_MY_IPV4_ADDR="192.0.2.1"
CONFIG_NET_CONFIG_PEER_IPV4_ADDR="192.0.2.2"

CONFIG_LOG=y
CONFIG_SHELL_CMDS_RESIZE=n

CONFIG_CACHE_MANAGEMENT=y
CONFIG_SPEED_OPTIMIZATIONS=y
CONFIG_TIMESLICING=n

# For speed optimizations
CONFIG_PICOLIBC_USE_MODULE=y
```

## app.overlay
```dts
/ {
    cdc_ncm_eth0: cdc-ncm-eth0 {
        compatible = "c2usb,cdc-ncm-ethernet";
        function-name = "c2usb-ncm-eth";
    };
};
```

## src/main.cpp
```c
// SPDX-License-Identifier: Apache-2.0
#include <zephyr/drivers/hwinfo.h>
#include <zephyr/logging/log.h>
#include <zephyr/net/net_config.h>

#ifdef CONFIG_NET_LOOPBACK_SIMULATE_PACKET_DROP
#include <zephyr/net/loopback.h>
#endif

#include <magic_enum.hpp>
#include <usb/df/class/cdc_ncm.hpp>
#include <usb/df/config_factory.hpp>
#include <usb/df/device.hpp>
#include <usb/df/vendor/microsoft/os_extension.hpp>
#include <usb/df/vendor/zephyr/cdc_ncm_ethernet.hpp>
#include <usb/df/vendor/zephyr/udc_mac.hpp>
#include <zephyr/thread.hpp>

LOG_MODULE_REGISTER(usb_ncm_zperf, LOG_LEVEL_INF);

using namespace zephyr;

constexpr usb::cdc::mac_address ncm_mac_address{0x00, 0x00, 0x5e, 0x00, 0x53, 0x01};

#if 1 // disable for generated MAC address for the netif
extern "C" void c2usb_cdc_ncm_ethernet_get_mac([[maybe_unused]] const ::device* dev,
                                               uint8_t* mac_address)
{
    std::copy(ncm_mac_address.begin(), ncm_mac_address.end(), mac_address);
    mac_address[5] ^= 1;
}
#endif

std::array<uint8_t, CONFIG_HWINFO_DEVICE_ID_LENGTH> serial_number{};

constexpr usb::product_info product_info{CONFIG_DEMO_MANUFACTURER_ID, CONFIG_DEMO_MANUFACTURER,
                                         CONFIG_DEMO_PRODUCT_ID,      CONFIG_DEMO_PRODUCT,
                                         usb::version("1.0"),         serial_number};

auto& device()
{
    static usb::df::zephyr::udc_mac mac{DEVICE_DT_GET(DT_NODELABEL(zephyr_udc0)), 128};
    // support for USB-NCM on Windows pre 11 through MSOS descriptors:
    static usb::df::microsoft::descriptors msos_desc{};
    static usb::df::device_instance<mac.supported_speeds()> device{mac, product_info, msos_desc};
    return device;
}

template <std::size_t SIZE>
using ntb_array = std::array<uint32_t, SIZE>;

int main()
{
    hwinfo_get_device_id(serial_number.data(), serial_number.size());

    C2USB_USB_TRANSFER_ALIGN(static ntb_array<1024>, ntb_in){};
    C2USB_USB_TRANSFER_ALIGN(static ntb_array<1024>, ntb_out){};

    auto* ncm_function =
        usb::df::zephyr::cdc_ncm_ethernet::construct<DT_NODE_FULL_NAME(DT_NODELABEL(cdc_ncm_eth0))>(
            ncm_mac_address, {ntb_in, ntb_out}
#if 1 // should work both ways
            ,
            DEVICE_DT_GET(DT_NODELABEL(cdc_ncm_eth0))
#endif
        );
    if (ncm_function == nullptr)
    {
        LOG_ERR("Failed to construct NCM function");
        return -1;
    }

    using namespace usb::df::config;
    using namespace std::chrono_literals;

    constexpr auto speeds = usb::df::zephyr::udc_mac::supported_speeds();
    static std::array<std::array<element, 7>, speeds.count()> config_store{};

    for (const auto speed : speeds)
    {
        config_store[speeds.offset(speed)] = make_config(
            header(power::bus(200), magic_enum::enum_name(speed).data()),
            ncm_function->config_entry(speed, usb::endpoint::address(0x02),
                                       usb::endpoint::address(0x82), usb::endpoint::address(0x81),
                                       usb::endpoint::interval::from_rate(speed, 8ms)));
        device().set_config_for_speed(config_store[speeds.offset(speed)], speed);
    }
    device().open();

    (void)net_config_init_app(NULL, "Initializing network");

#ifdef CONFIG_NET_LOOPBACK_SIMULATE_PACKET_DROP
    loopback_set_packet_drop_ratio(1);
#endif
#if defined(CONFIG_NET_DHCPV4) && !defined(CONFIG_NET_CONFIG_SETTINGS)
    net_dhcpv4_start(net_if_get_default());
#endif
    return 0;
}
```
