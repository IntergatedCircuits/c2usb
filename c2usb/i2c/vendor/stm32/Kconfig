## c2usb/i2c/vendor/stm32/Kconfig
```kconfig
menuconfig C2USB_I2C_STM32
    bool "c2usb STM32 HAL I2C target driver"
    default y
    depends on DT_HAS_C2USB_STM32_I2C_V1_TARGET_ENABLED || DT_HAS_C2USB_STM32_I2C_V2_TARGET_ENABLED
    select DMA
    select GPIO
    select PINCTRL
    select USE_STM32_HAL_I2C if !C2USB_I2C_STM32_V1 && !C2USB_I2C_STM32_HAL_TARGET_ONLY
    select USE_STM32_HAL_DMA
    help
      I2C target (slave) driver for the STM32 I2C v1 and v2 IPs, using the STM32Cube
      HAL I2C driver with DMA transfers. The DMA channels are reserved in the Zephyr
      DMA driver, which routes their interrupts to the HAL DMA driver.

if C2USB_I2C_STM32

config C2USB_I2C_STM32_V1
    bool
    default y if DT_HAS_C2USB_STM32_I2C_V1_TARGET_ENABLED
    help
      The SoC has the I2C v1 IP. The HAL I2C module of these series is disabled
      in hal_stm32 (due to macro name collisions with <zephyr/drivers/i2c.h>),
      so the HAL I2C driver is built as part of c2usb.

config C2USB_I2C_STM32_HAL_TARGET_ONLY
    bool "Build the HAL I2C driver without controller mode code"
    default n
    depends on DT_HAS_C2USB_STM32_I2C_V2_TARGET_ENABLED
    help
      The HAL I2C driver keeps references to its controller (master) mode DMA ISRs
      from the code shared with target mode, so the controller mode code is linked
      even if unused. This option builds a private copy of the HAL I2C driver with
      those references removed, saving about 1 kB of code.
      Has no effect if the HAL I2C driver is enabled by other users
      (USE_STM32_HAL_I2C), as the controller mode DMA APIs aren't functional
      in the private copy.
      Only applies to the I2C v2 IP, the v1 IP HAL doesn't have this issue.

config C2USB_I2C_STM32_INIT_PRIORITY
    int "c2usb STM32 I2C target driver init priority"
    default KERNEL_INIT_PRIORITY_DEVICE
    help
      Must be initialized after the DMA driver (DMA_INIT_PRIORITY).

module = C2USB_I2C_STM32
module-str = c2usb STM32 I2C target
source "subsys/logging/Kconfig.template.log_config"

endif # C2USB_I2C_STM32
```

## zephyr/drivers/usb/udc_vbus/Kconfig
```kconfig
# SPDX-License-Identifier: MPL-2.0

menuconfig C2USB_UDC_VBUS
    bool "VBUS sense GPIO for UDC drivers"
    # the "vbus-gpios" property is not declared in most UDC bindings, so it can only be detected
    # on the conventional label of the controller, other cases must be enabled manually
    default y if $(dt_nodelabel_has_prop,zephyr_udc0,vbus-gpios)
    select GPIO
    select UDC_DRIVER
    help
      Report the VBUS state of a UDC from a GPIO, if the UDC driver cannot detect it.
      Enabled per controller by adding a "vbus-gpios" property to the UDC devicetree node,
      that is the input pin which is active when VBUS is present:

        &zephyr_udc0 { vbus-gpios = <&gpioa 9 GPIO_ACTIVE_HIGH>; };

      The pin is read from interrupt context, so its GPIO controller must be accessible
      without sleeping. It is ignored (and left untouched) if the UDC driver can detect VBUS.

if C2USB_UDC_VBUS

module = C2USB_UDC_VBUS
module-str = c2usb UDC VBUS
source "subsys/logging/Kconfig.template.log_config"

config C2USB_UDC_VBUS_DEBOUNCE_MS
    int "VBUS sense debounce time in milliseconds"
    default 0
    help
      Time the pin level must be stable before the change is reported.
      When 0, every edge is evaluated and reported immediately from the interrupt.

endif # C2USB_UDC_VBUS
```

## zephyr/dts/bindings/i2c/c2usb,stm32-i2c-target-common.yaml
```yaml
# Common properties of the c2usb STM32 I2C target controller bindings.
# Not a binding by itself, included by c2usb,stm32-i2c-v1-target.yaml and
# c2usb,stm32-i2c-v2-target.yaml.

include: [base.yaml, pinctrl-device.yaml]

bus: i2c-target

properties:
  "#address-cells":
    required: true
    const: 1

  "#size-cells":
    required: true
    const: 0

  clock-frequency:
    type: int
    description: |
      I2C bus frequency in Hz. On the v2 IP it selects the timings entry,
      on the v1 IP it's passed to the HAL. Defaults to I2C_BITRATE_STANDARD.

  reg:
    required: true

  interrupts:
    required: true

  clocks:
    required: true

  pinctrl-0:
    required: true

  pinctrl-names:
    required: true

  dmas:
    required: true
    description: |
      DMA channels used by the I2C peripheral, for TX and RX transfers.

  dma-names:
    required: true
    description: |
      Names of the DMA channels, must be "tx" and "rx".

  scl-gpios:
    type: phandle-array
    description: Unused, accepted for compatibility with the st,stm32-i2c-v1/v2 bindings.

  sda-gpios:
    type: phandle-array
    description: Unused, accepted for compatibility with the st,stm32-i2c-v1/v2 bindings.
```

## zephyr/dts/bindings/i2c/c2usb,stm32-i2c-v1-target.yaml
```yaml
description: |
  STM32 I2C v1 IP (st,stm32-i2c-v1) controller operated in I2C target mode by c2usb,
  using the STM32Cube HAL I2C driver with DMA transfers.

  Override the compatible of the SoC's I2C node to use this driver instead of
  the Zephyr STM32 I2C driver. The target function is described by a child node,
  in the same way as the Linux kernel describes the device on the controller side.
  Only a single child node is supported.

  The node provides the "i2c-target" bus (instead of "i2c"), so that the child nodes
  are matched with their target side bindings, even when the same compatible
  also has a controller side binding (e.g. "hid-over-i2c").

  Both the I2C and the DMA channel interrupts drive the HAL state machine,
  so their interrupt priorities must be identical.

  The v1 IP has no timing register, the HAL derives the peripheral configuration
  from the APB1 clock rate and clock-frequency.

  Example:
    &dma1 {
      status = "okay";
    };

    &i2c3 {
      compatible = "c2usb,stm32-i2c-v1-target";
      clock-frequency = <I2C_BITRATE_STANDARD>;
      dmas = <&dma1 4 3 (STM32_DMA_PERIPH_TX | STM32_DMA_PRIORITY_HIGH) 0>,
             <&dma1 2 3 (STM32_DMA_PERIPH_RX | STM32_DMA_PRIORITY_HIGH) 0>;
      dma-names = "tx", "rx";
      status = "okay";

      hid@a {
        compatible = "hid-over-i2c";
        reg = <0x0a>;
        hid-descr-addr = <0x0001>;
        int-gpios = <&gpioc 6 GPIO_ACTIVE_LOW>;
      };
    };

compatible: "c2usb,stm32-i2c-v1-target"

include: c2usb,stm32-i2c-target-common.yaml
```

## zephyr/dts/bindings/i2c/c2usb,stm32-i2c-v2-target.yaml
```yaml
description: |
  STM32 I2C v2 IP (st,stm32-i2c-v2) controller operated in I2C target mode by c2usb,
  using the STM32Cube HAL I2C driver with DMA transfers.

  Override the compatible of the SoC's I2C node to use this driver instead of
  the Zephyr STM32 I2C driver. The target function is described by a child node,
  in the same way as the Linux kernel describes the device on the controller side.
  Only a single child node is supported.

  The node provides the "i2c-target" bus (instead of "i2c"), so that the child nodes
  are matched with their target side bindings, even when the same compatible
  also has a controller side binding (e.g. "hid-over-i2c").

  Both the I2C and the DMA channel interrupts drive the HAL state machine,
  so their interrupt priorities must be identical.

  Example:
    &dma1 {
      status = "okay";
    };

    &i2c2 {
      compatible = "c2usb,stm32-i2c-v2-target";
      clock-frequency = <I2C_BITRATE_STANDARD>;
      timings = <48000000 I2C_BITRATE_STANDARD 0x10A35D83>;
      dmas = <&dma1 4 (STM32_DMA_PERIPH_TX | STM32_DMA_PRIORITY_HIGH)>,
             <&dma1 5 (STM32_DMA_PERIPH_RX | STM32_DMA_PRIORITY_HIGH)>;
      dma-names = "tx", "rx";
      status = "okay";

      hid@a {
        compatible = "hid-over-i2c";
        reg = <0x0a>;
        hid-descr-addr = <0x0001>;
        int-gpios = <&gpioc 5 GPIO_ACTIVE_LOW>;
      };
    };

compatible: "c2usb,stm32-i2c-v2-target"

include: c2usb,stm32-i2c-target-common.yaml

properties:
  timings:
    type: array
    required: true
    description: |
      Table of pre-computed I2C_TIMINGR register values with the matching clock
      configuration, in the format of <periph_clock clock-frequency timing>,
      identical to the st,stm32-i2c-v2 binding. The entry matching the I2C
      peripheral clock rate and clock-frequency is applied.
      Even in target mode, the data setup and hold times (SCLDEL, SDADEL) are
      applied from this register. Compute the values with STM32CubeMX.
```

## zephyr/dts/bindings/input/hid-over-i2c-target.yaml
```yaml
description: |
  HID over I2C device function, target side.
  Describes the local device under an I2C target controller node
  (e.g. c2usb,stm32-i2c-v2-target), using the same compatible and properties
  as the Linux kernel binding for the remote device on the controller side.

compatible: "hid-over-i2c"

include: base.yaml

on-bus: i2c-target

properties:
  reg:
    required: true
    description: The device's own target address on the I2C bus.

  hid-descr-addr:
    type: int
    required: true
    description: The I2C register address of the HID descriptor.

  int-gpios:
    type: phandle-array
    required: true
    description: |
      The interrupt line output, signalling pending input reports to the host.
      Typically active low.
```

## zephyr/dts/bindings/input/hid-over-i2c.yaml
```yaml
description: |
  HID over I2C device, controller side.
  Describes a remote HID over I2C device attached to an I2C controller,
  following the Linux kernel binding (Documentation/devicetree/bindings/input/hid-over-i2c.yaml).
  No driver is provided for it in c2usb, the binding reserves the controller side meaning
  of the compatible, see hid-over-i2c-target.yaml for the target side.

compatible: "hid-over-i2c"

include: i2c-device.yaml

properties:
  hid-descr-addr:
    type: int
    required: true
    description: The I2C register address of the HID descriptor.

  int-gpios:
    type: phandle-array
    description: |
      The interrupt line input, signalling pending input reports from the device.
      Alternative to the interrupts property.

  reset-gpios:
    type: phandle-array
    description: GPIO specifier for the device's reset pin (active low).

  vdd-supply:
    type: phandle
    description: Regulator for the device's VDD supply.

  post-power-on-delay-ms:
    type: int
    description: Time required by the device after enabling its regulators or powering it on.

  post-reset-deassert-delay-ms:
    type: int
    description: Time required by the device after the reset line is deasserted.

  wakeup-source:
    type: boolean
    description: The device can wake up the system.
```

## zephyr/tests/i2c/hid_target_loopback/testcase.yaml
```yaml
common:
  tags:
    - stm32
    - i2c
    - hid
    - c2usb
  harness: ztest
  harness_config:
    # the two I2C buses of the chip are shorted, see boards/<board>.overlay
    fixture: i2c_bus_short
  platform_allow:
    - nucleo_l476rg
  integration_platforms:
    - nucleo_l476rg

tests:
  c2usb.i2c.hid_target_loopback.keyboard:
    extra_configs:
      - CONFIG_TEST_I2C_HID_APP_KEYBOARD=y
  c2usb.i2c.hid_target_loopback.recording_app:
    extra_configs:
      - CONFIG_TEST_I2C_HID_APP_RECORDING=y
```
