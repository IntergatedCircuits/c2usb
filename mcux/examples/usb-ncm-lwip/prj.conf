## CMakeLists.txt
```
cmake_minimum_required(VERSION 3.22.0)

set(CMAKE_EXPORT_COMPILE_COMMANDS ON)
set(CMAKE_CXX_STANDARD 20)
set(CMAKE_CXX_STANDARD_REQUIRED ON)
set(WEST ON) # necessary for looking up mcux modules from west workspace

include("${SdkRootDirPath}/cmake/extension/mcux.cmake")
project(
    usb-ncm-lwip
    LANGUAGES ASM C CXX
)
include("${SdkRootDirPath}/CMakeLists.txt")
include("${SdkRootDirPath}/examples/lwip_examples/httpsrv_common/freertos/CMakeLists.txt")
include("${SdkRootDirPath}/examples/lwip_examples/httpsrv_common/fs_data/CMakeLists.txt")
include("${SdkRootDirPath}/examples/lwip_examples/httpsrv_common/fs_data/webpage/CMakeLists.txt")

if(CMAKE_C_COMPILER_ID STREQUAL "GNU" AND CMAKE_C_COMPILER_VERSION VERSION_GREATER_EQUAL 14)
    set_source_files_properties(
        "${SdkRootDirPath}/middleware/lwip/src/apps/httpsrv/httpsrv_sha1.c"
        PROPERTIES COMPILE_OPTIONS "-Wno-stringop-overread"
    )
endif()

mcux_add_macro(
    CC "-DUSB_STACK_BM -DPRINTF_ADVANCED_ENABLE=1"
)
mcux_add_macro(
    TOOLCHAINS armgcc
    CC "-D_POSIX_SOURCE"
)
mcux_add_source(
    SOURCES
        src/main.cpp
)
mcux_add_include(
    BASE_PATH "${SdkRootDirPath}"
    INCLUDES "examples/_boards/${board}"
)

mcux_add_linker_symbol(
    SYMBOLS "__stack_size__=2048\
             __heap_size__=60000"
)

mcux_convert_binary(
    BINARY "${APPLICATION_BINARY_DIR}/${MCUX_SDK_PROJECT_NAME}.hex"
)
```

## prj.conf
```kconfig
CONFIG_MCUX_PRJSEG_module.board.pinmux_board_folder=y
CONFIG_MCUX_PRJSEG_module.board.boardfile=n
CONFIG_MCUX_PRJSEG_module.board.console_lite=n
CONFIG_MCUX_HAS_PRJSEG_project.use_hw_app=n

CONFIG_C2USB=y
CONFIG_C2USB_MCUX_MAC=y
CONFIG_C2USB_LWIP_NCM_NETIF=y

# SEGGER J-Link RTT Debug Console
CONFIG_MCUX_COMPONENT_utility.debug_console_rtt=y
CONFIG_LWIP_DEBUG=y
CONFIG_NETIF_DEBUG="LWIP_DBG_ON"
#CONFIG_ETHARP_DEBUG="LWIP_DBG_ON"
#CONFIG_IP_DEBUG="LWIP_DBG_ON"
#CONFIG_TCP_DEBUG="LWIP_DBG_ON"
#CONFIG_TCP_INPUT_DEBUG="LWIP_DBG_ON"
#CONFIG_TCP_OUTPUT_DEBUG="LWIP_DBG_ON"
#CONFIG_UDP_DEBUG="LWIP_DBG_ON"
#CONFIG_TCPIP_DEBUG="LWIP_DBG_ON"

# lwIP HTTP server configuration, matching the SDK's FreeRTOS HTTPSRV example.
CONFIG_MCUX_COMPONENT_middleware.lwip=y
CONFIG_MCUX_COMPONENT_middleware.lwip.apps.httpsrv=y
CONFIG_MCUX_COMPONENT_middleware.lwip.apps.mdns=y
CONFIG_MCUX_PRJSEG_middleware.lwip.generated_config=y
CONFIG_LWIP_OPT_H_CODE_LINE_1="void sys_lock_tcpip_core(void);"
CONFIG_LWIP_OPT_H_CODE_LINE_2="void sys_unlock_tcpip_core(void);"
CONFIG_LWIP_OPT_H_CODE_LINE_3="void sys_check_core_locking(void);"
CONFIG_LWIP_OPT_H_CODE_LINE_4="void sys_mark_tcpip_thread(void);"
CONFIG_LWIP_IGMP=y
CONFIG_LWIP_MDNS_RESPONDER=y
CONFIG_LWIP_NUM_NETIF_CLIENT_DATA=1
CONFIG_SYS_LIGHTWEIGHT_PROT=y
CONFIG_NO_SYS=n
CONFIG_LWIP_NETCONN=y
CONFIG_LWIP_SOCKET=y
CONFIG_LWIP_SO_RCVTIMEO=y
CONFIG_LWIP_TCPIP_CORE_LOCKING=y
CONFIG_LOCK_TCPIP_CORE_CUSTOM( )="sys_lock_tcpip_core()"
CONFIG_UNLOCK_TCPIP_CORE_CUSTOM( )="sys_unlock_tcpip_core()"
CONFIG_LWIP_ASSERT_CORE_LOCKED( )="sys_check_core_locking()"
CONFIG_LWIP_MARK_TCPIP_THREAD( )="sys_mark_tcpip_thread()"
CONFIG_MEM_ALIGNMENT=4
CONFIG_MEM_SIZE=22528
CONFIG_MEMP_NUM_PBUF=15
CONFIG_MEMP_NUM_UDP_PCB=7
CONFIG_MEMP_NUM_TCP_PCB=10
CONFIG_MEMP_NUM_TCP_PCB_LISTEN=6
CONFIG_MEMP_NUM_TCP_SEG=22
CONFIG_MEMP_NUM_SYS_TIMEOUT="20"
CONFIG_MEMP_NUM_REASSDATA=2
CONFIG_PBUF_POOL_SIZE=5
CONFIG_LWIP_TCP=y
CONFIG_TCP_TTL=255
CONFIG_TCP_QUEUE_OOSEQ=n
CONFIG_TCP_MSS=1460
CONFIG_TCP_SND_BUF="(6 * TCP_MSS)"
CONFIG_TCP_SND_QUEUELEN="((3 * TCP_SND_BUF) / TCP_MSS)"
CONFIG_TCP_WND="(2 * TCP_MSS)"
CONFIG_TCP_LISTEN_BACKLOG=y
CONFIG_LWIP_NETIF_API=y
CONFIG_LWIP_ICMP=y
CONFIG_LWIP_DHCP=n
CONFIG_LWIP_UDP=y
CONFIG_UDP_TTL=255
CONFIG_LWIP_STATS=n
CONFIG_LWIP_PROVIDE_ERRNO=y
CONFIG_LWIP_IPV6=n
CONFIG_LWIP_IPV4=y
CONFIG_DEFAULT_THREAD_STACKSIZE=3000
CONFIG_DEFAULT_THREAD_PRIO=3
CONFIG_TCPIP_MBOX_SIZE=32
CONFIG_TCPIP_THREAD_STACKSIZE=1024
CONFIG_TCPIP_THREAD_PRIO=8
CONFIG_DEFAULT_RAW_RECVMBOX_SIZE=12
CONFIG_DEFAULT_UDP_RECVMBOX_SIZE=12
CONFIG_DEFAULT_TCP_RECVMBOX_SIZE=12
CONFIG_DEFAULT_ACCEPTMBOX_SIZE=12
CONFIG_LWIP_NETIF_EXT_STATUS_CALLBACK=y
CONFIG_IP_REASS_MAX_PBUFS=4
CONFIG_LWIP_SINGLE_NETIF=y
CONFIG_HTTPSRV_CFG_WEBSOCKET_ENABLED=n

CONFIG_FREERTOS_MCPP_SHIM=y
# FreeRTOS configuration:
CONFIG_MCUX_COMPONENT_middleware.freertos-kernel=y
CONFIG_MCUX_COMPONENT_middleware.freertos-kernel.cm33_non_trustzone=y
CONFIG_MCUX_COMPONENT_middleware.freertos-kernel.heap_3=y
CONFIG_MCUX_PRJSEG_middleware.freertos-kernel.generated_config=y
CONFIG_configUSE_PREEMPTION=y
CONFIG_configUSE_TICKLESS_IDLE=0
CONFIG_configCPU_CLOCK_HZ="(SystemCoreClock)"
CONFIG_configTICK_RATE_HZ=1000
CONFIG_configMAX_PRIORITIES=18
CONFIG_configMINIMAL_STACK_SIZE=90
CONFIG_configMAX_TASK_NAME_LEN=20
CONFIG_configUSE_16_BIT_TICKS=n
CONFIG_configIDLE_SHOULD_YIELD=y
CONFIG_configUSE_TASK_NOTIFICATIONS=y
CONFIG_configUSE_MUTEXES=y
CONFIG_configUSE_RECURSIVE_MUTEXES=y
CONFIG_configUSE_COUNTING_SEMAPHORES=y
CONFIG_configQUEUE_REGISTRY_SIZE=8
CONFIG_configUSE_QUEUE_SETS=n
CONFIG_configUSE_TIME_SLICING=n
CONFIG_configUSE_NEWLIB_REENTRANT=n
CONFIG_configENABLE_BACKWARD_COMPATIBILITY=n
CONFIG_configNUM_THREAD_LOCAL_STORAGE_POINTERS=5
CONFIG_configUSE_APPLICATION_TASK_TAG=n
CONFIG_configINCLUDE_FREERTOS_TASK_C_ADDITIONS_H=y
CONFIG_configTOTAL_HEAP_SIZE=0
CONFIG_configAPPLICATION_ALLOCATED_HEAP=n
CONFIG_configUSE_IDLE_HOOK=n
CONFIG_configUSE_TICK_HOOK=n
CONFIG_configCHECK_FOR_STACK_OVERFLOW=n
CONFIG_configUSE_MALLOC_FAILED_HOOK=n
CONFIG_configUSE_DAEMON_TASK_STARTUP_HOOK=n
CONFIG_configGENERATE_RUN_TIME_STATS=n
CONFIG_configUSE_TRACE_FACILITY=y
CONFIG_configUSE_STATS_FORMATTING_FUNCTIONS=y
CONFIG_configUSE_CO_ROUTINES=n
CONFIG_configMAX_CO_ROUTINE_PRIORITIES=2
CONFIG_configUSE_TIMERS=y
CONFIG_configTIMER_TASK_PRIORITY="17"
CONFIG_configTIMER_QUEUE_LENGTH=10
CONFIG_configTIMER_TASK_STACK_DEPTH="(configMINIMAL_STACK_SIZE * 2)"
CONFIG_configASSERT(x)="if((x) == 0) {taskDISABLE_INTERRUPTS(); for (;;);}"
CONFIG_INCLUDE_vTaskPrioritySet=y
CONFIG_INCLUDE_uxTaskPriorityGet=y
CONFIG_INCLUDE_vTaskDelete=y
CONFIG_INCLUDE_vTaskSuspend=y
CONFIG_INCLUDE_vTaskDelayUntil=y
CONFIG_INCLUDE_vTaskDelay=y
CONFIG_INCLUDE_xTaskGetSchedulerState=y
CONFIG_INCLUDE_xTaskGetCurrentTaskHandle=y
CONFIG_INCLUDE_uxTaskGetStackHighWaterMark=n
CONFIG_INCLUDE_xTaskGetIdleTaskHandle=n
CONFIG_INCLUDE_eTaskGetState=n
CONFIG_INCLUDE_xTimerPendFunctionCall=y
CONFIG_INCLUDE_xTaskAbortDelay=n
CONFIG_INCLUDE_xTaskGetHandle=n
CONFIG_INCLUDE_xTaskResumeFromISR=y
```

## src/main.cpp
```c
// SPDX-License-Identifier: Apache-2.0
extern "C"
{
#include <FreeRTOS.h>
#include <board.h>
#include <httpsrv_freertos.h>
#include <lwip/netifapi.h>
#include <lwip/tcpip.h>
#include <pin_mux.h>
#if __has_include("fsl_spc.h")
#include <fsl_spc.h>
#endif
#include <task.h>
#include <usb_device_config.h>
#if __has_include("usb_phy.h")
#include <usb_phy.h>
#endif
#if __has_include("fsl_debug_console.h")
#include <fsl_debug_console.h>
#endif
}
#include <array>
#include <freertos/scheduler.hpp>
#include <usb/df/class/cdc_ncm.hpp>
#include <usb/df/config_factory.hpp>
#include <usb/df/device.hpp>
#include <usb/df/vendor/lwip/ncm_netif.hpp>
#include <usb/df/vendor/microsoft/os_extension.hpp>
#include <usb/df/vendor/nxp/mcux_mac.hpp>

constexpr usb::cdc::mac_address netif_mac{0x00, 0x00, 0x5e, 0x00, 0x53, 0x00};
constexpr usb::cdc::mac_address ncm_mac{0x00, 0x00, 0x5e, 0x00, 0x53, 0x01};
constexpr usb::product_info product{0x1FC9, "NXP", 0x00A2, "c2usb NCM HTTP server",
                                    usb::version("1.0")};
constexpr usb::speeds supported_speeds{usb::speed::FULL
#if USB_DEVICE_CONFIG_EHCI
                                       ,
                                       usb::speed::HIGH
#endif
};

auto& usb_mac()
{
    static std::array<uint8_t, 128> ctrl_msg_buffer{};
    static auto mac{
#if USB_DEVICE_CONFIG_EHCI
        usb::df::nxp::mcux_mac::ehci(ctrl_msg_buffer)
#elif USB_DEVICE_CONFIG_KHCI
        usb::df::nxp::mcux_mac::khci(ctrl_msg_buffer)
#endif
    };
    return mac;
}

auto& usb_device()
{
    static usb::df::microsoft::descriptors msos{};
    static usb::df::device_instance<supported_speeds> instance{usb_mac(), product, msos};
    return instance;
}

#if __has_include("fsl_spc.h")
extern "C" void BOARD_PowerMode_OD(void)
{
    spc_active_mode_dcdc_option_t dcdc_config{
        .DCDCVoltage = kSPC_DCDC_OverdriveVoltage,
        .DCDCDriveStrength = kSPC_DCDC_NormalDriveStrength,
    };
    SPC_SetActiveModeDCDCRegulatorConfig(SPC0, &dcdc_config);

    spc_sram_voltage_config_t sram_config{
        .operateVoltage = kSPC_sramOperateAt1P2V,
        .requestVoltageUpdate = true,
    };
    SPC_SetSRAMOperateVoltage(SPC0, &sram_config);
}
#endif

void app_thread(void*)
{
    using namespace usb::df;
    using namespace std::chrono_literals;

    static lwip::ncm_netif ncm_netif{netif_mac, freertos::thread::get_current()};

    using ntb_array = std::array<uint32_t, 1024>;
    C2USB_USB_TRANSFER_ALIGN(static ntb_array, ntb_in){};
    C2USB_USB_TRANSFER_ALIGN(static ntb_array, ntb_out){};
    static cdc::ncm::function ncm_function{ncm_mac, ncm_netif, {ntb_in, ntb_out}};

    ip4_addr_t address;
    ip4_addr_t netmask;
    ip4_addr_t gateway;
    IP4_ADDR(&address, 192, 0, 2, 1);
    IP4_ADDR(&netmask, 255, 255, 255, 0);
    IP4_ADDR(&gateway, 0, 0, 0, 0);

    tcpip_init(nullptr, nullptr);
    if (netifapi_netif_add(ncm_netif.netif_handle(), &address, &netmask, &gateway, &ncm_netif,
                           &lwip::ncm_netif::init, &tcpip_input) != ERR_OK)
    {
        configASSERT(false);
    }
    (void)netifapi_netif_set_default(ncm_netif.netif_handle());
    (void)netifapi_netif_set_up(ncm_netif.netif_handle());

    http_server_enable_mdns(ncm_netif.netif_handle(), "usb-ncm");
    http_server_print_ip_cfg(ncm_netif.netif_handle());
    http_server_socket_init();

    static std::array<std::array<config::element, 7>, supported_speeds.count()> configurations{};
    for (const auto speed : supported_speeds)
    {
        configurations[supported_speeds.offset(speed)] = make_config(
            config::header(config::power::bus(200), "USB NCM"),
            ncm_function.config_entry(speed, usb::endpoint::address(0x02),
                                      usb::endpoint::address(0x82), usb::endpoint::address(0x81),
                                      usb::endpoint::interval::from_rate(speed, 8ms)));
        usb_device().set_config_for_speed(configurations[supported_speeds.offset(speed)], speed);
    }
    usb_device().open();

    ncm_netif.worker();
}

extern "C" void BOARD_InitHardware(void)
{
#if USB_DEVICE_CONFIG_EHCI
    /* attach FRO 12M to FLEXCOMM4 (debug console) */
    CLOCK_SetClkDiv(kCLOCK_DivFlexcom4Clk, 1u);
    CLOCK_AttachClk(BOARD_DEBUG_UART_CLK_ATTACH);

    /* enable clock for GPIO*/
    CLOCK_EnableClock(kCLOCK_Gpio0);
    CLOCK_EnableClock(kCLOCK_Gpio4);

    BOARD_InitPins();
    BOARD_PowerMode_OD();
    BOARD_InitBootClocks();

#elif USB_DEVICE_CONFIG_KHCI
    BOARD_InitBootClocks();
    BOARD_InitBootPins();
#endif
#if __has_include("fsl_debug_console.h")
    DbgConsole_Init();
#endif
}

extern "C" void USB_DeviceClockInit(void)
{
#if USB_DEVICE_CONFIG_EHCI
    usb_phy_config_struct_t phy_config{
        BOARD_USB_PHY_D_CAL,
        BOARD_USB_PHY_TXCAL45DP,
        BOARD_USB_PHY_TXCAL45DM,
    };
    SPC0->ACTIVE_VDELAY = 0x0500;
    SPC0->ACTIVE_CFG &= ~SPC_ACTIVE_CFG_CORELDO_VDD_DS_MASK;
    SPC0->ACTIVE_CFG |= SPC_ACTIVE_CFG_DCDC_VDD_LVL(0x3) | SPC_ACTIVE_CFG_CORELDO_VDD_LVL(0x3) |
                        SPC_ACTIVE_CFG_SYSLDO_VDD_DS_MASK | SPC_ACTIVE_CFG_DCDC_VDD_DS(0x2u);
    while (SPC0->SC & SPC_SC_BUSY_MASK)
    {
    }
    if ((SCG0->LDOCSR & SCG_LDOCSR_LDOEN_MASK) == 0)
    {
        SCG0->TRIM_LOCK = 0x5a5a0001U;
        SCG0->LDOCSR |= SCG_LDOCSR_LDOEN_MASK;
        while ((SCG0->LDOCSR & SCG_LDOCSR_VOUT_OK_MASK) == 0)
        {
        }
    }
    SYSCON->AHBCLKCTRLSET[2] |= SYSCON_AHBCLKCTRL2_USB_HS_MASK | SYSCON_AHBCLKCTRL2_USB_HS_PHY_MASK;
    SCG0->SOSCCFG &= ~(SCG_SOSCCFG_RANGE_MASK | SCG_SOSCCFG_EREFS_MASK);
    SCG0->SOSCCFG = (1U << SCG_SOSCCFG_RANGE_SHIFT) | (1U << SCG_SOSCCFG_EREFS_SHIFT);
    SCG0->SOSCCSR |= SCG_SOSCCSR_SOSCEN_MASK;
    while ((SCG0->SOSCCSR & SCG_SOSCCSR_SOSCVLD_MASK) == 0)
    {
    }
    SYSCON->CLOCK_CTRL |=
        SYSCON_CLOCK_CTRL_CLKIN_ENA_MASK | SYSCON_CLOCK_CTRL_CLKIN_ENA_FM_USBH_LPT_MASK;
    CLOCK_EnableClock(kCLOCK_UsbHs);
    CLOCK_EnableClock(kCLOCK_UsbHsPhy);
    CLOCK_EnableUsbhsPhyPllClock(kCLOCK_Usbphy480M, 24000000U);
    CLOCK_EnableUsbhsClock();
    USB_EhciPhyInit(usb_mac().controller_id(), BOARD_XTAL0_CLK_HZ, &phy_config);
    NVIC_SetPriority(USB1_HS_IRQn, configLIBRARY_MAX_SYSCALL_INTERRUPT_PRIORITY);
#else
    NVIC_SetPriority(USB0_IRQn, configLIBRARY_MAX_SYSCALL_INTERRUPT_PRIORITY);
#if FSL_FEATURE_USB_KHCI_IRC48M_MODULE_CLOCK_ENABLED
    CLOCK_EnableUsbfs0Clock(kCLOCK_UsbSrcIrc48M, 48000000U);
#else
    CLOCK_EnableUsbfs0Clock(kCLOCK_UsbSrcPll0, CLOCK_GetFreq(kCLOCK_PllFllSelClk));
#endif
#endif
}

#if USB_DEVICE_CONFIG_EHCI
extern "C" void USB1_HS_IRQHandler(void)
#elif USB_DEVICE_CONFIG_KHCI
extern "C" void USB0_IRQHandler(void)
#endif
{
    usb_mac().handle_irq();
    SDK_ISR_EXIT_BARRIER;
}

int main(void)
{
    BOARD_InitHardware();
    USB_DeviceClockInit();

    using namespace freertos;

    [[maybe_unused]] auto* main_thread =
        make_thread(&app_thread, nullptr, 3000, tskIDLE_PRIORITY + 3, "main");
    assert(main_thread != nullptr);
    scheduler::start();

    __builtin_unreachable();
}
```
